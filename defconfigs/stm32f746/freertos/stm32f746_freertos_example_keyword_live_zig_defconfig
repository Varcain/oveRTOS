## defconfigs/stm32f746/freertos/stm32f746_freertos_example_keyword_live_zig_defconfig
```kconfig
CONFIG_OVE_APP_EXAMPLE_KEYWORD_LIVE_ZIG=y
CONFIG_OVE_APP_LANG_ZIG=y
CONFIG_OVE_RTOS_FREERTOS=y
CONFIG_OVE_BOARD_STM32F746G_DISCO=y
CONFIG_OVE_SYNC=y
CONFIG_OVE_CONSOLE=y
CONFIG_OVE_LOG=y
CONFIG_OVE_TIME=y
CONFIG_OVE_BSP=y
CONFIG_OVE_INFER=y
CONFIG_OVE_AUDIO=y
CONFIG_OVE_AUDIO_NODE_CONVERTER=y
CONFIG_OVE_LOG_LEVEL_INF=y
CONFIG_FREERTOS_TOTAL_HEAP_SIZE=65536
CONFIG_FREERTOS_SOURCE_GIT=y
CONFIG_OVE_TOOLCHAIN_DOWNLOAD=y
```

## defconfigs/stm32f746/freertos/stm32f746_freertos_example_net_rust_defconfig
```kconfig
CONFIG_OVE_APP_EXAMPLE_NET_RUST=y
CONFIG_OVE_APP_LANG_RUST=y
CONFIG_OVE_RTOS_FREERTOS=y
CONFIG_OVE_BOARD_STM32F746G_DISCO=y
CONFIG_OVE_SYNC=y
CONFIG_OVE_CONSOLE=y
CONFIG_OVE_LOG=y
CONFIG_OVE_TIME=y
CONFIG_OVE_BSP=y
CONFIG_OVE_NET=y
CONFIG_OVE_NET_HTTP=y
CONFIG_OVE_NET_MQTT=y
CONFIG_OVE_NET_HTTPD=y
CONFIG_OVE_LOG_LEVEL_INF=y
CONFIG_FREERTOS_TOTAL_HEAP_SIZE=131072
CONFIG_FREERTOS_TIMER_TASK_STACK_DEPTH=512
CONFIG_FREERTOS_SOURCE_GIT=y
CONFIG_OVE_TOOLCHAIN_DOWNLOAD=y
```

## defconfigs/stm32f746/freertos/stm32f746_freertos_example_net_zeroheap_defconfig
```kconfig
CONFIG_OVE_APP_EXAMPLE_NET=y
CONFIG_OVE_APP_LANG_C=y
CONFIG_OVE_RTOS_FREERTOS=y
CONFIG_OVE_BOARD_STM32F746G_DISCO=y
CONFIG_OVE_SYNC=y
CONFIG_OVE_CONSOLE=y
CONFIG_OVE_LOG=y
CONFIG_OVE_TIME=y
CONFIG_OVE_BSP=y
CONFIG_OVE_NET=y
CONFIG_OVE_NET_HTTP=y
CONFIG_OVE_NET_MQTT=y
CONFIG_OVE_NET_HTTPD=y
CONFIG_OVE_LOG_LEVEL_INF=y
CONFIG_OVE_ZERO_HEAP=y
CONFIG_OVE_NET_HTTP_MAX_RESPONSE=8192
CONFIG_OVE_NET_TLS_HEAP_SIZE=32768
CONFIG_FREERTOS_TIMER_TASK_STACK_DEPTH=512
CONFIG_FREERTOS_SOURCE_GIT=y
CONFIG_OVE_TOOLCHAIN_DOWNLOAD=y
```

## defconfigs/stm32f746/nuttx/stm32f746_nuttx_benchmark_defconfig
```kconfig
CONFIG_OVE_APP_BENCHMARK=y
CONFIG_OVE_APP_LANG_C=y
CONFIG_OVE_RTOS_NUTTX=y
CONFIG_OVE_BOARD_STM32F746G_DISCO=y
CONFIG_OVE_SYNC=y
CONFIG_OVE_CONSOLE=y
CONFIG_OVE_LOG=y
CONFIG_OVE_TIME=y
CONFIG_OVE_BSP=y
CONFIG_OVE_QUEUE=y
CONFIG_OVE_TIMER=y
CONFIG_OVE_EVENTGROUP=y
CONFIG_OVE_WORKQUEUE=y
CONFIG_OVE_STREAM=y
CONFIG_OVE_LOG_LEVEL_INF=y
CONFIG_NUTTX_SOURCE_GIT=y
CONFIG_OVE_TOOLCHAIN_DOWNLOAD=y
```

## defconfigs/stm32f746/nuttx/stm32f746_nuttx_example_net_rust_zeroheap_defconfig
```kconfig
CONFIG_OVE_APP_EXAMPLE_NET_RUST=y
CONFIG_OVE_APP_LANG_RUST=y
CONFIG_OVE_RTOS_NUTTX=y
CONFIG_OVE_BOARD_STM32F746G_DISCO=y
CONFIG_OVE_RUST_TOOLCHAIN_SYSTEM=y
CONFIG_OVE_SYNC=y
CONFIG_OVE_CONSOLE=y
CONFIG_OVE_LOG=y
CONFIG_OVE_TIME=y
CONFIG_OVE_BSP=y
CONFIG_OVE_NET=y
CONFIG_OVE_NET_HTTP=y
CONFIG_OVE_NET_MQTT=y
CONFIG_OVE_NET_HTTPD=y
CONFIG_OVE_LOG_LEVEL_INF=y
CONFIG_OVE_ZERO_HEAP=y
CONFIG_NUTTX_SOURCE_GIT=y
CONFIG_OVE_TOOLCHAIN_DOWNLOAD=y
```

## defconfigs/stm32f746/nuttx/stm32f746_nuttx_example_net_zeroheap_defconfig
```kconfig
CONFIG_OVE_APP_EXAMPLE_NET=y
CONFIG_OVE_APP_LANG_C=y
CONFIG_OVE_RTOS_NUTTX=y
CONFIG_OVE_BOARD_STM32F746G_DISCO=y
CONFIG_OVE_SYNC=y
# CONFIG_OVE_AUDIO is not set
# CONFIG_OVE_FS is not set
CONFIG_OVE_CONSOLE=y
CONFIG_OVE_LOG=y
CONFIG_OVE_TIME=y
CONFIG_OVE_BSP=y
# CONFIG_OVE_LVGL is not set
CONFIG_OVE_QUEUE=y
CONFIG_OVE_TIMER=y
CONFIG_OVE_EVENTGROUP=y
# CONFIG_OVE_SHELL is not set
# CONFIG_OVE_NVS is not set
# CONFIG_OVE_WATCHDOG is not set
# CONFIG_OVE_WORKQUEUE is not set
# CONFIG_OVE_STREAM is not set
CONFIG_OVE_NET=y
CONFIG_OVE_NET_HTTP=y
CONFIG_OVE_NET_MQTT=y
CONFIG_OVE_NET_HTTPD=y
CONFIG_OVE_LOG_LEVEL_INF=y
CONFIG_OVE_ZERO_HEAP=y
CONFIG_OVE_NET_HTTP_MAX_RESPONSE=8192
CONFIG_NUTTX_SOURCE_GIT=y
CONFIG_OVE_TOOLCHAIN_DOWNLOAD=y
```

## defconfigs/stm32f746/nuttx/stm32f746_nuttx_example_rust_zeroheap_defconfig
```kconfig
CONFIG_OVE_APP_EXAMPLE_RUST=y
CONFIG_OVE_APP_LANG_RUST=y
CONFIG_OVE_RTOS_NUTTX=y
CONFIG_OVE_BOARD_STM32F746G_DISCO=y
CONFIG_OVE_RUST_TOOLCHAIN_SYSTEM=y
CONFIG_OVE_SYNC=y
CONFIG_OVE_CONSOLE=y
CONFIG_OVE_LOG=y
CONFIG_OVE_TIME=y
CONFIG_OVE_BSP=y
CONFIG_OVE_LVGL=y
CONFIG_OVE_QUEUE=y
CONFIG_OVE_TIMER=y
CONFIG_OVE_LOG_LEVEL_INF=y
CONFIG_NUTTX_SOURCE_GIT=y
CONFIG_OVE_TOOLCHAIN_DOWNLOAD=y
CONFIG_OVE_ZERO_HEAP=y
```

## defconfigs/stm32f746/zephyr/stm32f746_zephyr_example_c_zeroheap_defconfig
```kconfig
CONFIG_OVE_APP_EXAMPLE_C=y
CONFIG_OVE_APP_LANG_C=y
CONFIG_OVE_RTOS_ZEPHYR=y
CONFIG_OVE_BOARD_STM32F746G_DISCO=y
CONFIG_OVE_SYNC=y
CONFIG_OVE_CONSOLE=y
CONFIG_OVE_LOG=y
CONFIG_OVE_TIME=y
CONFIG_OVE_BSP=y
CONFIG_OVE_LVGL=y
CONFIG_OVE_QUEUE=y
CONFIG_OVE_TIMER=y
CONFIG_OVE_LOG_LEVEL_INF=y
CONFIG_ZEPHYR_SOURCE_WEST=y
CONFIG_OVE_ZERO_HEAP=y
```

## defconfigs/wasm/posix/wasm_posix_benchmark_defconfig
```kconfig
CONFIG_OVE_APP_BENCHMARK=y
CONFIG_OVE_APP_LANG_C=y
CONFIG_OVE_RTOS_POSIX=y
CONFIG_OVE_BOARD_WASM=y
CONFIG_OVE_SYNC=y
CONFIG_OVE_CONSOLE=y
CONFIG_OVE_LOG=y
CONFIG_OVE_TIME=y
CONFIG_OVE_QUEUE=y
CONFIG_OVE_TIMER=y
CONFIG_OVE_EVENTGROUP=y
CONFIG_OVE_WORKQUEUE=y
CONFIG_OVE_STREAM=y
CONFIG_OVE_LOG_LEVEL_INF=y
CONFIG_OVE_SIM=y
```

## defconfigs/wasm/posix/wasm_posix_example_c_defconfig
```kconfig
CONFIG_OVE_RTOS_POSIX=y
CONFIG_OVE_BOARD_WASM=y
CONFIG_OVE_APP_EXAMPLE_C=y
CONFIG_OVE_APP_LANG_C=y
CONFIG_OVE_SIM=y
CONFIG_OVE_SYNC=y
CONFIG_OVE_CONSOLE=y
CONFIG_OVE_LOG=y
CONFIG_OVE_TIME=y
CONFIG_OVE_BSP=y
CONFIG_OVE_LVGL=y
CONFIG_OVE_QUEUE=y
CONFIG_OVE_TIMER=y
```

## defconfigs/wasm/posix/wasm_posix_example_cpp_defconfig
```kconfig
CONFIG_OVE_APP_EXAMPLE_CPP=y
CONFIG_OVE_APP_LANG_CXX=y
CONFIG_OVE_RTOS_POSIX=y
CONFIG_OVE_BOARD_WASM=y
CONFIG_OVE_SYNC=y
CONFIG_OVE_CONSOLE=y
CONFIG_OVE_LOG=y
CONFIG_OVE_TIME=y
CONFIG_OVE_BSP=y
CONFIG_OVE_LVGL=y
CONFIG_OVE_QUEUE=y
CONFIG_OVE_TIMER=y
CONFIG_OVE_LOG_LEVEL_INF=y
CONFIG_OVE_SIM=y
```

## defconfigs/wasm/posix/wasm_posix_example_keyword_live_rust_defconfig
```kconfig
CONFIG_OVE_APP_EXAMPLE_KEYWORD_LIVE_RUST=y
CONFIG_OVE_APP_LANG_RUST=y
CONFIG_OVE_RTOS_POSIX=y
CONFIG_OVE_BOARD_WASM=y
CONFIG_OVE_SIM=y
CONFIG_OVE_SYNC=y
CONFIG_OVE_CONSOLE=y
CONFIG_OVE_LOG=y
CONFIG_OVE_TIME=y
CONFIG_OVE_TIMER=y
CONFIG_OVE_AUDIO=y
CONFIG_OVE_AUDIO_NODE_CONVERTER=y
CONFIG_OVE_INFER=y
```

## defconfigs/wasm/posix/wasm_posix_example_net_rust_defconfig
```kconfig
CONFIG_OVE_APP_EXAMPLE_NET_RUST=y
CONFIG_OVE_APP_LANG_RUST=y
CONFIG_OVE_RTOS_POSIX=y
CONFIG_OVE_BOARD_WASM=y
CONFIG_OVE_SYNC=y
CONFIG_OVE_CONSOLE=y
CONFIG_OVE_LOG=y
CONFIG_OVE_TIME=y
CONFIG_OVE_TIMER=y
CONFIG_OVE_BSP=y
CONFIG_OVE_NET=y
CONFIG_OVE_NET_HTTP=y
CONFIG_OVE_NET_MQTT=y
CONFIG_OVE_NET_HTTPD=y
CONFIG_OVE_LOG_LEVEL_INF=y
CONFIG_OVE_SIM=y
```

## defconfigs/wasm/posix/wasm_posix_example_pm_c_defconfig
```kconfig
CONFIG_OVE_APP_EXAMPLE_PM_C=y
CONFIG_OVE_APP_LANG_C=y
CONFIG_OVE_RTOS_POSIX=y
CONFIG_OVE_BOARD_WASM=y
CONFIG_OVE_SIM=y
CONFIG_OVE_SYNC=y
CONFIG_OVE_CONSOLE=y
CONFIG_OVE_LOG=y
CONFIG_OVE_TIME=y
CONFIG_OVE_TIMER=y
CONFIG_OVE_PM=y
```

## tests/sim/i2c-retirement-nuttx/nuttx_app/Kconfig
```kconfig
# SPDX-License-Identifier: GPL-3.0-or-later
config EXTERNAL_OVE_TEST
	tristate "oveRTOS I2C retirement test"
	default n
if EXTERNAL_OVE_TEST
config EXTERNAL_OVE_TEST_PROGNAME
	string "Program name"
	default "ove_test"
config EXTERNAL_OVE_TEST_PRIORITY
	int "Task priority"
	default 100
config EXTERNAL_OVE_TEST_STACKSIZE
	int "Stack size"
	default 16384
endif
```
