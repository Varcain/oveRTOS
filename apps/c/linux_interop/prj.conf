## CMakeLists.txt
```
# Copyright (C) 2026 Kamil Lulko <kamil.lulko@gmail.com>
#
# SPDX-License-Identifier: GPL-3.0-or-later
#
# This file is part of oveRTOS.
#
# C example app: an RTOS kernel thread and a Linux program running side by side
# (RTOS <-> Linux-personality interop). This is a STANDALONE Zephyr USERSPACE
# app (its own CMakeLists/prj.conf, not an app.yaml framework app) because the
# Linux personality needs mps2/an521 (Cortex-M33 + MPU + CONFIG_USERSPACE); the
# framework's QEMU board (mps2-an500, Cortex-M3) has no MPU and cannot host it.
# See README.md for the build/run command.

cmake_minimum_required(VERSION 3.20.0)
find_package(Zephyr REQUIRED HINTS $ENV{ZEPHYR_BASE})
project(ove_linux_interop)

set(OVE_ROOT ${CMAKE_CURRENT_SOURCE_DIR}/../../..)

# The demo (src/app.c) + the oveRTOS Zephyr backend primitives it uses
# (ove_thread / ove_queue / ove_time) + the Linux personality seam + the
# engine-agnostic layers the seam dispatches into.
target_sources(app PRIVATE
    src/app.c
    ${OVE_ROOT}/backends/zephyr/zephyr_thread.c
    ${OVE_ROOT}/backends/zephyr/zephyr_queue.c
    ${OVE_ROOT}/backends/zephyr/zephyr_time.c
    ${OVE_ROOT}/backends/zephyr/zephyr_lnx.c
    ${OVE_ROOT}/backends/common/ove_arena.c
    ${OVE_ROOT}/loader/ove_loader.c
    ${OVE_ROOT}/linux/ove_linux_syscall.c
)
target_include_directories(app PRIVATE
    ${CMAKE_CURRENT_SOURCE_DIR}      # ove_config.h
    ${OVE_ROOT}/include
    ${OVE_ROOT}/backends/common      # ove_backend_common.h
    ${OVE_ROOT}/backends/zephyr/include  # ove_storage_zephyr.h (real storage sizes)
    ${OVE_ROOT}/tests/ontarget       # loader_rootfs_image.h (the embedded Buildroot rootfs)
)

# The seam traps the program's svc by interposing the engine's software-fault
# handler at link time (no Zephyr source patch); svc #0 is "Unused" in Zephyr's
# dispatch, so it reaches z_do_kernel_oops, and --wrap routes it to the seam.
target_link_options(app PUBLIC "-Wl,--wrap=z_do_kernel_oops")
```

## prj.conf
```kconfig
# Copyright (C) 2026 Kamil Lulko <kamil.lulko@gmail.com>
#
# SPDX-License-Identifier: GPL-3.0-or-later
#
# This file is part of oveRTOS.
#
# Built for mps2/an521/cpu0 (Cortex-M33). CONFIG_USERSPACE gives unprivileged
# user threads + MPU memory domains — the substrate the Linux personality needs
# to run a loaded program unprivileged and trap its svc. The native RTOS worker
# thread runs alongside it as a privileged kernel thread.
CONFIG_USERSPACE=y
CONFIG_MAIN_STACK_SIZE=8192
CONFIG_CONSOLE=y
CONFIG_PRINTK=y
CONFIG_THREAD_NAME=y
# The oveRTOS Zephyr thread backend stores its handle in the kernel thread's
# custom-data slot.
CONFIG_THREAD_CUSTOM_DATA=y
# z_do_kernel_oops()'s callee-saved-register argument (r7 = the Linux syscall
# number) is only populated with CONFIG_EXTRA_EXCEPTION_INFO on Armv7/8-M.
CONFIG_EXTRA_EXCEPTION_INFO=y
```

## src/app.c
```c
/*
 * Copyright (C) 2026 Kamil Lulko <kamil.lulko@gmail.com>
 *
 * SPDX-License-Identifier: GPL-3.0-or-later
 *
 * This file is part of oveRTOS.
 *
 * Engine-neutral RTOS/Linux-personality interoperability demo.
 */

#include "ove/app.h"
#include "ove/lxp.h"
#include "ove/thread.h"

#include "ove_config.h"
#include "ove/build.h"
#include "network_smoke.h"
#include "qualification.h"
#include "roundtrip.h"

#define GUEST_ENTRYPOINT "/usr/libexec/ove-interop-guest"

static ove_lxp_host_t g_linux_host;

static int run_guest_mode(const ove_lxp_launch_config_t *config, const char *mode)
{
	const char *const argv[] = {"ove-interop-guest", mode, NULL};
	return ove_lxp_host_run(&g_linux_host, config, GUEST_ENTRYPOINT, 2, argv);
}

static void demo_exit(unsigned int code)
{
	ove_lxp_host_deinit(&g_linux_host);
	ove_app_exit(code);
}

static ove_thread_t g_demo;
/* The O0 QEMU integration build uses 4320 bytes of this coordinator stack;
 * retain nearly another call-chain of margin in backend-safe host memory. */
OVE_THREAD_DEFINE_HOST(g_demo_storage, 8192);

static void demo_body(void *arg)
{
	(void)arg;
	ove_lxp_console_init();
	ove_lxp_console_write(
		"=== oveRTOS demo: a native RTOS thread + a Linux program, two-way ===\n");
	ove_lxp_console_write("[build] " OVE_BUILD_ID "\n");

#if defined(CONFIG_OVE_LINUX_RT_SCOPE)
	if (ove_lxp_rt_scope_start(ove_lxp_console_write) != OVE_OK) {
		ove_lxp_console_write("[rt-scope] FAIL: timer/event/thread setup\n");
		demo_exit(1);
	}
	ove_lxp_console_write("[rt-scope] CH1=D3/PB4 TIM3 1kHz reference; "
			      "CH2=D4/PG7 critical-thread response\n");
#endif

	linux_interop_qualification_start();

	int host_rc = ove_lxp_host_init(&g_linux_host);
	if (host_rc != OVE_OK) {
		ove_lxp_console_printf("[demo] FAIL: Linux host init failed rc=%d\n", host_rc);
		demo_exit(1);
	}

	linux_interop_network_report(&g_linux_host);

	ove_lxp_console_write("\n-- phase 1: RTOS thread <-> Linux program (bidirectional) --\n");
	ove_lxp_launch_config_t cfg1 = {0};
	ove_lxp_rt_scope_bind(&cfg1);
	int roundtrip_rc = linux_interop_roundtrip_prepare(&cfg1);
	if (roundtrip_rc != OVE_OK) {
		ove_lxp_console_printf("[demo] FAIL: round-trip worker init rc=%d\n", roundtrip_rc);
		demo_exit(1);
	}
	ove_lxp_console_bind_diagnostics(&cfg1);
	ove_lxp_console_write("[demo] launching the Linux guest round-trip mode...\n");
	int rc1 = run_guest_mode(&cfg1, "roundtrip");
	if (linux_interop_roundtrip_complete(rc1) != OVE_OK)
		demo_exit(1);

	linux_interop_network_smoke(&g_linux_host);

	linux_interop_qualification_arm_guest_tests();

#if defined(CONFIG_OVE_LINUX_GUEST_FP_SELFTEST)
	ove_lxp_console_write("\n-- phase 2: hard-float guest context self-test --\n");
#else
	ove_lxp_console_write("\n-- phase 2: booting uClinux (BusyBox init -> rcS -> login shell;"
			      " run commands, `poweroff` to halt) --\n");
#endif
	ove_lxp_launch_config_t cfg2 = {0};
	ove_lxp_rt_scope_bind(&cfg2);
	ove_lxp_console_bind_diagnostics(&cfg2);
	ove_lxp_console_bind(&cfg2);
	int rc2;
	if (linux_interop_qualification_measurement_start() != OVE_OK) {
		ove_lxp_console_write("[demo] FAIL: latency monitor thread init\n");
		demo_exit(1);
	}
#if defined(CONFIG_OVE_LINUX_GUEST_FP_SELFTEST)
	rc2 = run_guest_mode(&cfg2, "fpcheck");
	ove_lxp_console_write("\n=== interop demo done (hard-float self-test exited) ===\n");
#else
	rc2 = run_guest_mode(&cfg2, "boot");
	ove_lxp_console_write("\n=== interop demo done (uClinux halted) ===\n");
#endif
	linux_interop_qualification_measurement_stop();
	if (rc2 != 0)
		ove_lxp_console_printf("[demo] FAIL: phase-2 guest exited rc=%d\n", rc2);
	ove_lxp_host_observation_t observation;
	if (ove_lxp_host_observe(&g_linux_host, &observation) != OVE_OK) {
		ove_lxp_console_write("[demo] FAIL: post-run LXP observation unavailable\n");
		demo_exit(1);
	}
	linux_interop_qualification_report(&observation, g_demo, sizeof(g_demo_storage_stack));
	demo_exit(rc2 == 0 ? 0 : 1);
}

void ove_main(void)
{
	if (OVE_THREAD_INIT_DEFINED(g_demo, g_demo_storage, "demo", demo_body, NULL,
				    OVE_PRIO_NORMAL) != OVE_OK) {
		ove_lxp_console_write("[demo] FAIL: demo thread init\n");
		demo_exit(1);
	}
	ove_run();
}
```

## src/network_smoke.c
```c
/*
 * Copyright (C) 2026 Kamil Lulko <kamil.lulko@gmail.com>
 *
 * SPDX-License-Identifier: GPL-3.0-or-later
 *
 * Application-owned network readiness reporting and TCP smoke workload.
 */

#include "network_smoke.h"

#include "ove_config.h"
#include "ove/lxp_console.h"

#if defined(CONFIG_OVE_LINUX_NET)
#include <stddef.h>

#include "ove/net.h"
#include "ove/thread.h"
#include "ove/time.h"
#endif

void linux_interop_network_report(const ove_lxp_host_t *host)
{
#if defined(CONFIG_OVE_LINUX_NET)
	ove_sockaddr_t ip = {0}, gateway = {0};
	if (ove_lxp_host_netif_get_addr(host, &ip, &gateway, NULL) == OVE_OK) {
		ove_lxp_console_printf("[demo] eth0 up ip=%u.%u.%u.%u gw=%u.%u.%u.%u\n",
				       (unsigned int)ip.addr[0], (unsigned int)ip.addr[1],
				       (unsigned int)ip.addr[2], (unsigned int)ip.addr[3],
				       (unsigned int)gateway.addr[0], (unsigned int)gateway.addr[1],
				       (unsigned int)gateway.addr[2],
				       (unsigned int)gateway.addr[3]);
	} else {
		ove_lxp_console_write("[demo] eth0 address unavailable after bring-up\n");
	}
#else
	(void)host;
#endif
}

void linux_interop_network_smoke(const ove_lxp_host_t *host)
{
#if defined(CONFIG_OVE_LINUX_NET)
	static ove_socket_storage_t socket_storage;
	ove_sockaddr_t peer = {0};
	if (ove_lxp_host_netif_get_addr(host, NULL, &peer, NULL) != OVE_OK) {
		ove_lxp_console_write("[demo] socket smoke: configured gateway unavailable\n");
		return;
	}
	peer.port = 22;
	const uint64_t started_ns = ove_time_now_steady_ns();
	int last_rc = -1;
	for (uint32_t attempt = 1; attempt <= 12; attempt++) {
		ove_socket_t socket = NULL;
		last_rc = ove_socket_open(&socket, &socket_storage, OVE_AF_INET, OVE_SOCK_STREAM);
		if (last_rc != OVE_OK)
			goto retry;

		last_rc = ove_socket_connect(socket, &peer, OVE_MS(500));
		if (last_rc != OVE_OK) {
			ove_socket_close(socket);
			goto retry;
		}

		char reply[80];
		size_t received = 0;
		last_rc = ove_socket_recv(socket, reply, sizeof(reply) - 1, &received, OVE_SEC(1));
		if (last_rc == OVE_OK && received > 0) {
			for (size_t i = 0; i < received; i++)
				if (reply[i] == '\r' || reply[i] == '\n')
					reply[i] = 0;
			reply[received < sizeof(reply) ? received : sizeof(reply) - 1] = 0;
			ove_lxp_console_printf(
				"[demo] socket smoke (post-phase1) OK <- %u.%u.%u.%u:22: %s "
				"(ready after %u ms, attempt %u)\n",
				(unsigned int)peer.addr[0], (unsigned int)peer.addr[1],
				(unsigned int)peer.addr[2], (unsigned int)peer.addr[3], reply,
				(unsigned int)((ove_time_now_steady_ns() - started_ns) / OVE_MS(1)),
				(unsigned int)attempt);
			ove_socket_close(socket);
			return;
		}
		ove_socket_close(socket);

	retry:
		if (attempt < 12)
			ove_thread_sleep_ms(250);
	}

	ove_lxp_console_printf(
		"[demo] socket smoke (post-phase1): not ready after %u ms, last rc=%d\n",
		(unsigned int)((ove_time_now_steady_ns() - started_ns) / OVE_MS(1)), last_rc);
#else
	(void)host;
#endif
}
```

## src/network_smoke.h
```c
/*
 * Copyright (C) 2026 Kamil Lulko <kamil.lulko@gmail.com>
 *
 * SPDX-License-Identifier: GPL-3.0-or-later
 */

#ifndef LINUX_INTEROP_NETWORK_SMOKE_H
#define LINUX_INTEROP_NETWORK_SMOKE_H

#include "ove/lxp_host.h"

/* Report configured host addressing when networking is enabled. */
void linux_interop_network_report(const ove_lxp_host_t *host);

/* Perform the demo's bounded TCP readiness probe when networking is enabled. */
void linux_interop_network_smoke(const ove_lxp_host_t *host);

#endif /* LINUX_INTEROP_NETWORK_SMOKE_H */
```

## src/qualification.c
```c
/*
 * Copyright (C) 2026 Kamil Lulko <kamil.lulko@gmail.com>
 *
 * SPDX-License-Identifier: GPL-3.0-or-later
 *
 * This file is part of oveRTOS.
 *
 * Qualification-only support for the Linux interop demo. Production flow in
 * app.c uses the same small lifecycle regardless of which probes a profile
 * enables; destructive tests, deadline measurement, and resource reporting
 * remain contained here.
 */

#include "qualification.h"

#include <stdio.h>

#include "ove/lxp_console.h"
#include "ove/lxp_host.h"
#include "ove/time.h"
#if defined(CONFIG_OVE_WATCHDOG)
#include "ove/reset.h"
#include "ove/watchdog.h"
#endif

#include "ove_config.h"

#define THREAD_AUDIT_CAPACITY 2u

struct thread_audit_snapshot {
	const char *name;
	int available;
	size_t used;
	size_t size;
};

static struct thread_audit_snapshot g_thread_audits[THREAD_AUDIT_CAPACITY];
static size_t g_thread_audit_count;

#if defined(CONFIG_OVE_WATCHDOG)
/*
 * A high-priority task owns the IWDG feed. It feeds freely while the
 * coordinator is idle, but requires a changing coordinator heartbeat while a
 * guest is active. Guest progress is deliberately not part of this policy: an
 * isolated guest fault must not reset the host, and a guest cannot hold the
 * watchdog open.
 */
#define WD_TIMEOUT_MS 2000u
#define WD_FEED_MS 250u
/* Above the Linux coordinator, so a wedged coordinator cannot starve its own watchdog. */
#define WD_MONITOR_PRIO OVE_PRIO_HIGH

static ove_thread_t g_wd;
#if defined(CONFIG_OVE_DEBUG_BUILD)
#define WD_STACK_SIZE 1024u
#else
#define WD_STACK_SIZE 512u
#endif
OVE_THREAD_DEFINE(g_wd_storage, WD_STACK_SIZE);
static ove_watchdog_t g_wd_dog;
static ove_watchdog_storage_t g_wd_dog_storage;
static int g_wd_started;

static int wd_should_feed(int active, int hb_advanced)
{
	return !active || hb_advanced;
}

#if defined(CONFIG_OVE_WATCHDOG_SELFTEST)
/*
 * Starve the coordinator without masking interrupts. The scheduler and monitor
 * stay alive, but the frozen heartbeat withholds the feed and proves the
 * watchdog policy end to end. A watchdog-recovery boot never re-trips it.
 * The spinner must outrank the coordinator and stay below the monitor, on
 * every engine.
 */
#define WDTEST_PRIO OVE_PRIO_ABOVE(OVE_PRIO_LXP_COORDINATOR, 1)
_Static_assert(WDTEST_PRIO > OVE_PRIO_LXP_COORDINATOR && WDTEST_PRIO < WD_MONITOR_PRIO,
	       "watchdog monitor > selftest spinner > Linux coordinator");
static ove_thread_t g_wdtest;
OVE_THREAD_DEFINE(g_wdtest_storage, 512);

static void wdtest_spin(void *arg)
{
	(void)arg;
	for (;;)
		__asm volatile("nop");
}

static void wd_selftest_maybe_trip(void)
{
	if (ove_reset_cause() == OVE_RESET_WATCHDOG) {
		ove_lxp_console_write(
			"[wd] selftest: recovered from the watchdog reset; not re-tripping\n");
		return;
	}
	ove_lxp_console_write("[wd] selftest: starving the coordinator (scheduler stays live);"
			      " expect a watchdog reset in ~2s...\n");
	(void)OVE_THREAD_INIT_DEFINED(g_wdtest, g_wdtest_storage, "wdtest", wdtest_spin, NULL,
				      WDTEST_PRIO);
}
#endif /* CONFIG_OVE_WATCHDOG_SELFTEST */

static void wd_body(void *arg)
{
	(void)arg;
	if (ove_watchdog_init(&g_wd_dog, &g_wd_dog_storage, WD_TIMEOUT_MS) != OVE_OK ||
	    ove_watchdog_start(g_wd_dog) != OVE_OK) {
		ove_lxp_console_write(
			"[wd] FAIL: could not arm IWDG; running without a watchdog\n");
		return;
	}
	ove_lxp_console_write(
		"[wd] IWDG armed: 2000ms timeout, fed every 250ms while the host stays live\n");

	uint32_t last = 0;
	int primed = 0;
#if defined(CONFIG_OVE_WATCHDOG_SELFTEST)
	unsigned cycle = 0;
	int tripped = 0;
#endif
	for (;;) {
		ove_lxp_run_health_t h;
		ove_lxp_run_health_snapshot(&h);
		int feed = !primed || wd_should_feed(h.active, h.coordinator_iterations != last);
		last = h.coordinator_iterations;
		primed = 1;
		if (feed)
			(void)ove_watchdog_feed(g_wd_dog);
#if defined(CONFIG_OVE_WATCHDOG_SELFTEST)
		if (!tripped && cycle >= 16 && h.active) {
			tripped = 1;
			wd_selftest_maybe_trip();
		}
		cycle++;
#endif
		ove_thread_sleep_ms(WD_FEED_MS);
	}
}
#endif /* CONFIG_OVE_WATCHDOG */

#if defined(CONFIG_OVE_LINUX_FAULTTEST)
/* Prove that a privileged host fault is fatal rather than guest-contained. */
static ove_thread_t g_ftest;
OVE_THREAD_DEFINE(g_ftest_storage, 512);

static void ftest_body(void *arg)
{
	(void)arg;
	ove_thread_sleep_ms(4000);
	ove_lxp_console_write("[c6] faulting a privileged host task (udf) while a guest runs;"
			      " expect HOST FAULT + watchdog reset\n");
	__asm volatile("udf #0");
	for (;;) {
	}
}

static void faulttest_maybe_arm(void)
{
	if (ove_reset_cause() == OVE_RESET_WATCHDOG) {
		ove_lxp_console_write("[c6] recovered from the host-fault test; not re-arming\n");
		return;
	}
	(void)OVE_THREAD_INIT_DEFINED(g_ftest, g_ftest_storage, "ftest", ftest_body, NULL,
				      OVE_PRIO_NORMAL);
}
#endif /* CONFIG_OVE_LINUX_FAULTTEST */

#if defined(CONFIG_OVE_LINUX_SMASHTEST)
/* Prove that a host stack canary failure reaches the board's fatal handler. */
static ove_thread_t g_smash;
OVE_THREAD_DEFINE(g_smash_storage, 512);

static __attribute__((noinline)) void smash_host_stack(void)
{
	volatile char buf[16];
	volatile char *p = buf;
	for (int i = 0; i < 40; i++)
		p[i] = (char)(0xa5 + i);
	__asm__ volatile("" : : "r"(p) : "memory");
}

static void smashtest_body(void *arg)
{
	(void)arg;
	ove_thread_sleep_ms(4500);
	ove_lxp_console_write(
		"[c9] smashing a host stack buffer; expect STACK SMASH + watchdog reset\n");
	smash_host_stack();
	for (;;) {
	}
}

static void smashtest_maybe_arm(void)
{
	if (ove_reset_cause() == OVE_RESET_WATCHDOG) {
		ove_lxp_console_write("[c9] recovered from the smash test; not re-arming\n");
		return;
	}
	(void)OVE_THREAD_INIT_DEFINED(g_smash, g_smash_storage, "smash", smashtest_body, NULL,
				      OVE_PRIO_NORMAL);
}
#endif /* CONFIG_OVE_LINUX_SMASHTEST */

#if defined(CONFIG_OVE_LINUX_LATENCY)
/* Measure high-priority host wake overshoot over exactly one guest run. */
#define MON_PERIOD_MS 10u

static ove_thread_t g_mon;
#if defined(CONFIG_OVE_DEBUG_BUILD)
#define MON_STACK_SIZE 1024u
#else
#define MON_STACK_SIZE 512u
#endif
OVE_THREAD_DEFINE(g_mon_storage, MON_STACK_SIZE);
static ove_lxp_latency_stat_t g_mon_late;
static int g_mon_started;

static void mon_body(void *arg)
{
	(void)arg;
	ove_thread_t self = ove_thread_get_self();
	const uint64_t period_ns = OVE_MS(MON_PERIOD_MS);
	while (!ove_thread_should_stop(self)) {
		uint64_t t0 = ove_time_now_steady_ns();
		ove_thread_sleep_ms(MON_PERIOD_MS);
		uint64_t slept = ove_time_now_steady_ns() - t0;
		ove_lxp_latency_record(&g_mon_late, slept > period_ns ? slept - period_ns : 0);
	}
}

static void lat_row(const char *what, const char *name, const ove_lxp_latency_stat_t *stat)
{
	if (!stat || !stat->count)
		return;
	ove_lxp_console_printf("[lat] %s%s%s n=%u max_ns=%u us[%u %u %u %u %u %u %u %u]\n", what,
			       name[0] ? " " : "", name, (unsigned int)stat->count,
			       (unsigned int)stat->max_ns, (unsigned int)stat->buckets[0],
			       (unsigned int)stat->buckets[1], (unsigned int)stat->buckets[2],
			       (unsigned int)stat->buckets[3], (unsigned int)stat->buckets[4],
			       (unsigned int)stat->buckets[5], (unsigned int)stat->buckets[6],
			       (unsigned int)stat->buckets[7]);
}

static void lat_report(const ove_lxp_host_observation_t *observation)
{
	ove_lxp_console_write("\n=== latency (measurement build; no threshold is enforced) ===\n"
			      "[lat] us[] buckets: <1 <2 <4 <8 <16 <32 <64 >=64\n");
	lat_row("host-wake-overshoot", "", &g_mon_late);
	for (uint32_t row = 0; row < observation->latency_service_count; row++)
		lat_row("coord-service", ove_lxp_observation_service_name(observation, row),
			&observation->latency_services[row].stat);
	for (uint32_t row = 0; row < observation->latency_wake_count; row++) {
		char name[12];
		(void)snprintf(name, sizeof(name), "%u",
			       (unsigned int)observation->latency_wakes[row].id);
		lat_row("guest-wake slot", name, &observation->latency_wakes[row].stat);
	}
	ove_lxp_console_write("[lat] end\n");
	ove_time_delay_ms(50);
}
#endif /* CONFIG_OVE_LINUX_LATENCY */

static void audit_stack_line(const char *name, int available, size_t used, size_t size)
{
	if (!available) {
		ove_lxp_console_printf("[stack] %-18s unavailable size=%u\n", name,
				       (unsigned int)size);
		return;
	}
	ove_lxp_console_printf("[stack] %-18s used=%u size=%u free=%u\n", name, (unsigned int)used,
			       (unsigned int)size, (unsigned int)(size > used ? size - used : 0));
}

static void audit_thread(const char *name, ove_thread_t thread, size_t stack_size)
{
	size_t headroom = 0;
	int available = ove_thread_get_stack_headroom(thread, &headroom) == OVE_OK;
	audit_stack_line(name, available, stack_size > headroom ? stack_size - headroom : 0,
			 stack_size);
}

static void host_observation_audit(const ove_lxp_host_observation_t *observation)
{
	const ove_lxp_size_observation_t *sizes = &observation->sizes;
	ove_lxp_console_printf("[lxp-size] slots=%u regions=%u proc=%u slot-core=%u region-core=%u "
			       "slot-table=%u coord-static=%u exec-capture=%u\n",
			       (unsigned int)sizes->slots, (unsigned int)sizes->regions,
			       (unsigned int)sizes->proc, (unsigned int)sizes->per_slot_core,
			       (unsigned int)sizes->per_region_core,
			       (unsigned int)sizes->slot_table,
			       (unsigned int)sizes->coordinator_static,
			       (unsigned int)sizes->exec_capture);
	ove_lxp_console_printf(
		"[lxp-size] mm=%u files=%u fs=%u sighand=%u group=%u arena=%u resume=%u "
		"mailbox=%u signal=%u\n",
		(unsigned int)sizes->mm, (unsigned int)sizes->files, (unsigned int)sizes->fs,
		(unsigned int)sizes->sighand, (unsigned int)sizes->thread_group,
		(unsigned int)sizes->arena, (unsigned int)sizes->resume_context,
		(unsigned int)sizes->deferred_request, (unsigned int)sizes->signal_save_stack);

	const ove_lxp_diagnostics_observation_t *health = &observation->diagnostics;
	if (!health->failures) {
		ove_lxp_console_printf("[lxp-world] checks=%u failures=0\n",
				       (unsigned int)health->checks);
	} else {
		ove_lxp_console_printf(
			"[lxp-world] checks=%u failures=%u first=%s slot=%d region=%d last=%s\n",
			(unsigned int)health->checks, (unsigned int)health->failures,
			ove_lxp_observation_issue_name(health->first_error.issue),
			(int)health->first_error.slot, (int)health->first_error.region,
			ove_lxp_observation_issue_name(health->last_error.issue));
	}
}

void linux_interop_qualification_start(void)
{
	g_thread_audit_count = 0;
#if defined(CONFIG_OVE_WATCHDOG)
	ove_lxp_console_write("[reset] cause: ");
	ove_lxp_console_write(ove_reset_cause_str(ove_reset_cause()));
	ove_lxp_console_write("\n");
	if (OVE_THREAD_INIT_DEFINED(g_wd, g_wd_storage, "wd", wd_body, NULL, WD_MONITOR_PRIO) !=
	    OVE_OK) {
		ove_lxp_console_write(
			"[wd] FAIL: monitor thread init; running without a watchdog\n");
		return;
	}
	g_wd_started = 1;
#endif
}

void linux_interop_qualification_observe_thread(const char *name, ove_thread_t thread,
						size_t stack_size)
{
	if (!name || !thread || !stack_size || g_thread_audit_count >= THREAD_AUDIT_CAPACITY)
		return;

	size_t headroom = 0;
	int available = ove_thread_get_stack_headroom(thread, &headroom) == OVE_OK;
	g_thread_audits[g_thread_audit_count++] = (struct thread_audit_snapshot){
		.name = name,
		.available = available,
		.used = available && stack_size > headroom ? stack_size - headroom : 0,
		.size = stack_size,
	};
}

void linux_interop_qualification_arm_guest_tests(void)
{
#if defined(CONFIG_OVE_LINUX_FAULTTEST)
	faulttest_maybe_arm();
#endif
#if defined(CONFIG_OVE_LINUX_SMASHTEST)
	smashtest_maybe_arm();
#endif
}

int linux_interop_qualification_measurement_start(void)
{
#if defined(CONFIG_OVE_LINUX_LATENCY)
	g_mon_late = (ove_lxp_latency_stat_t){0};
	int rc = OVE_THREAD_INIT_DEFINED(g_mon, g_mon_storage, "lat-mon", mon_body, NULL,
					 OVE_PRIO_HIGH);
	if (rc != OVE_OK)
		return rc;
	g_mon_started = 1;
#endif
	return OVE_OK;
}

void linux_interop_qualification_measurement_stop(void)
{
#if defined(CONFIG_OVE_LINUX_LATENCY)
	if (!g_mon_started)
		return;
	ove_thread_request_stop(g_mon);
	while (ove_thread_get_state(g_mon) != OVE_THREAD_STATE_TERMINATED)
		ove_thread_sleep_ms(1);
	linux_interop_qualification_observe_thread("lat-monitor", g_mon,
						   sizeof(g_mon_storage_stack));
	(void)ove_thread_deinit(g_mon);
	g_mon_started = 0;
#endif
}

void linux_interop_qualification_report(const ove_lxp_host_observation_t *observation,
					ove_thread_t coordinator, size_t coordinator_stack_size)
{
#if defined(CONFIG_OVE_LINUX_LATENCY)
	lat_report(observation);
#endif
	host_observation_audit(observation);
	ove_lxp_console_write("\n=== stack high-water audit (deepest usage this run) ===\n");
	audit_thread("coordinator", coordinator, coordinator_stack_size);
	for (size_t i = 0; i < g_thread_audit_count; i++)
		audit_stack_line(g_thread_audits[i].name, g_thread_audits[i].available,
				 g_thread_audits[i].used, g_thread_audits[i].size);
#if defined(CONFIG_OVE_WATCHDOG)
	if (g_wd_started)
		audit_thread("wd-monitor", g_wd, sizeof(g_wd_storage_stack));
#endif
	if (observation->guest_stack.available)
		audit_stack_line("guest-slot(tramp)", 1, observation->guest_stack.used,
				 observation->guest_stack.size);

	struct ove_mem_stats memory;
	if (ove_sys_get_mem_stats(&memory) == OVE_OK) {
		ove_lxp_console_printf("[heap] free=%u peak_used=%u total=%u\n",
				       (unsigned int)memory.free, (unsigned int)memory.peak_used,
				       (unsigned int)memory.total);
	}
	ove_lxp_console_write("[stack] end\n");
	ove_time_delay_ms(50);
}
```

## src/qualification.h
```c
/*
 * Copyright (C) 2026 Kamil Lulko <kamil.lulko@gmail.com>
 *
 * SPDX-License-Identifier: GPL-3.0-or-later
 *
 * This file is part of oveRTOS.
 */

#ifndef LINUX_INTEROP_QUALIFICATION_H
#define LINUX_INTEROP_QUALIFICATION_H

#include <stddef.h>

#include "ove/lxp_observability.h"
#include "ove/thread.h"

/* Start configured host safeguards, including the coordinator watchdog. */
void linux_interop_qualification_start(void);

/* Snapshot an owned thread's stack high-water mark before destroying it. */
void linux_interop_qualification_observe_thread(const char *name, ove_thread_t thread,
						size_t stack_size);

/* Arm destructive, one-shot probes for the active guest window. */
void linux_interop_qualification_arm_guest_tests(void);

/* Bound the optional latency measurement to the following guest run. */
int linux_interop_qualification_measurement_start(void);
void linux_interop_qualification_measurement_stop(void);

/* Print one coherent post-run host, personality, stack, and heap report. */
void linux_interop_qualification_report(const ove_lxp_host_observation_t *observation,
					ove_thread_t coordinator, size_t coordinator_stack_size);

#endif /* LINUX_INTEROP_QUALIFICATION_H */
```

## src/roundtrip.c
```c
/*
 * Copyright (C) 2026 Kamil Lulko <kamil.lulko@gmail.com>
 *
 * SPDX-License-Identifier: GPL-3.0-or-later
 *
 * Native RTOS <-> Linux guest round-trip scenario.
 */

#include "roundtrip.h"

#include <stdio.h>
#include <string.h>

#include "ove/lxp_console.h"
#include "ove/thread.h"
#include "ove/time.h"
#include "ove/types.h"

#include "qualification.h"

#define N_READINGS 3
#define LINE_CAPACITY 56

struct roundtrip_line {
	char text[LINE_CAPACITY];
};

static struct roundtrip_line g_feed_lines[N_READINGS];
static int g_feed_idx;
static char g_round_trip[N_READINGS][LINE_CAPACITY];
static int g_round_trip_n;

static ove_thread_t g_worker;
OVE_THREAD_DEFINE(g_worker_storage, 2048);

static void roundtrip_worker(void *arg)
{
	(void)arg;
	ove_thread_t self = ove_thread_get_self();
	int printed = 0;
	for (;;) {
		int available = __atomic_load_n(&g_round_trip_n, __ATOMIC_ACQUIRE);
		while (printed < available) {
			ove_lxp_console_printf(
				"[rtos-consumer] <- Linux (round trip #%d @ %u ms): \"%s\"\n",
				printed + 1, (unsigned int)(ove_time_now_steady_ns() / OVE_MS(1)),
				g_round_trip[printed]);
			printed++;
		}
		if (ove_thread_should_stop(self) && printed >= available)
			break;
		ove_thread_sleep_ms(50);
	}
}

static long feed_read(void *ctx, int fd, void *buf, size_t len)
{
	(void)ctx;
	(void)fd;
	if (g_feed_idx >= N_READINGS)
		return 0;
	const char *src = g_feed_lines[g_feed_idx++].text;
	size_t size = strlen(src);
	if (size > len)
		size = len;
	memcpy(buf, src, size);
	return (long)size;
}

static long consume_write(void *ctx, int fd, const void *buf, size_t len)
{
	(void)ctx;
	(void)fd;
	char text[LINE_CAPACITY];
	size_t size = len < sizeof(text) - 1 ? len : sizeof(text) - 1;
	memcpy(text, buf, size);
	while (size && (text[size - 1] == '\n' || text[size - 1] == '\r'))
		size--;
	text[size] = 0;
	if (size) {
		int index = __atomic_load_n(&g_round_trip_n, __ATOMIC_RELAXED);
		if (index < N_READINGS) {
			memcpy(g_round_trip[index], text, size + 1);
			__atomic_store_n(&g_round_trip_n, index + 1, __ATOMIC_RELEASE);
		}
	}
	return (long)len;
}

int linux_interop_roundtrip_prepare(ove_lxp_launch_config_t *config)
{
	if (!config)
		return OVE_ERR_INVALID_PARAM;
	memset(g_feed_lines, 0, sizeof(g_feed_lines));
	memset(g_round_trip, 0, sizeof(g_round_trip));
	g_feed_idx = 0;
	__atomic_store_n(&g_round_trip_n, 0, __ATOMIC_RELAXED);
	for (int i = 1; i <= N_READINGS; i++) {
		(void)snprintf(g_feed_lines[i - 1].text, sizeof(g_feed_lines[i - 1].text),
			       "reading-%d\n", i);
		ove_lxp_console_printf("[rtos-feeder] -> Linux: reading-%d\n", i);
	}

	config->write_fn = consume_write;
	config->read_fn = feed_read;
	config->io_ctx = NULL;
	return OVE_THREAD_INIT_DEFINED(g_worker, g_worker_storage, "rtos-worker", roundtrip_worker,
				       NULL, OVE_PRIO_LOW);
}

int linux_interop_roundtrip_complete(int guest_status)
{
	ove_thread_request_stop(g_worker);
	while (ove_thread_get_state(g_worker) != OVE_THREAD_STATE_TERMINATED)
		ove_thread_sleep_ms(1);
	linux_interop_qualification_observe_thread("worker", g_worker,
						   sizeof(g_worker_storage_stack));
	(void)ove_thread_deinit(g_worker);

	int received = __atomic_load_n(&g_round_trip_n, __ATOMIC_ACQUIRE);
	int valid = guest_status == 0 && received == N_READINGS;
	for (int i = 0; valid && i < N_READINGS; i++) {
		char expected[16];
		(void)snprintf(expected, sizeof(expected), "reading-%d", i + 1);
		valid = strcmp(g_round_trip[i], expected) == 0;
	}
	if (!valid) {
		ove_lxp_console_printf(
			"[demo] FAIL: phase-1 round trip mismatch rc=%d received=%d\n",
			guest_status, received);
		return OVE_ERR_IO;
	}
	ove_lxp_console_write(
		"[demo] phase 1 OK: 3 readings made the full RTOS -> Linux -> RTOS round trip.\n");
	return OVE_OK;
}
```

## src/roundtrip.h
```c
/*
 * Copyright (C) 2026 Kamil Lulko <kamil.lulko@gmail.com>
 *
 * SPDX-License-Identifier: GPL-3.0-or-later
 */

#ifndef LINUX_INTEROP_ROUNDTRIP_H
#define LINUX_INTEROP_ROUNDTRIP_H

#include "ove/lxp_launch.h"

/* Start the native worker and bind its allocation-free guest I/O callbacks. */
int linux_interop_roundtrip_prepare(ove_lxp_launch_config_t *config);

/* Stop the worker and verify the completed RTOS -> guest -> RTOS exchange. */
int linux_interop_roundtrip_complete(int guest_status);

#endif /* LINUX_INTEROP_ROUNDTRIP_H */
```

## src/rt_scope.h
```c
/*
 * Copyright (C) 2026 Kamil Lulko <kamil.lulko@gmail.com>
 *
 * SPDX-License-Identifier: GPL-3.0-or-later
 *
 * This file is part of oveRTOS.
 */

#ifndef LINUX_INTEROP_RT_SCOPE_H
#define LINUX_INTEROP_RT_SCOPE_H

#include <stddef.h>

typedef void (*linux_rt_scope_write_fn)(const char *text);

/* Start the STM32F746G-DISCO two-channel host real-time demonstration. */
int linux_rt_scope_start(linux_rt_scope_write_fn write_fn);

/* Format a coherent, non-destructive lifetime snapshot for /proc/rt_scope. */
long linux_rt_scope_proc_read(void *ctx, char *buf, size_t cap);

#endif /* LINUX_INTEROP_RT_SCOPE_H */
```
