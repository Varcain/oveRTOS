## Config.in
```kconfig
mainmenu "oveRTOS Configuration"

source "output/kconfig/apps/Config.in"
source "config/Config.in.rtos"
source "config/Config.in.hardware"
source "config/Config.in.modules"
source "config/Config.in.debug"
source "config/Config.in.toolchain"
```

## boards/qemu-mps2-an500/zephyr/drivers/Kconfig
```kconfig
config OVE_SHMEM_DISPLAY
	bool "oveRTOS semihosting framebuffer display"
	default y
	depends on DISPLAY
	help
	  Display driver that writes pixels to /dev/shm/ove-fb via ARM
	  semihosting.  Used by the QEMU dashboard bridge.
```

## boards/qemu-mps2-an500/zephyr/dts/bindings/ove,shmem-display.yaml
```yaml
description: |
  oveRTOS semihosting framebuffer display for QEMU.
  Writes pixels to /dev/shm/ove-fb via ARM semihosting,
  read by the host display viewer.

compatible: "ove,shmem-display"

include: display-controller.yaml

properties:
  width:
    type: int
    required: true
  height:
    type: int
    required: true
```

## boards/stm32f746g-discovery/zephyr/drivers/wm8994/Kconfig
```kconfig
# Copyright (C) 2026 Kamil Lulko <kamil.lulko@gmail.com>
#
# SPDX-License-Identifier: GPL-3.0-or-later
#
# This file is part of oveRTOS.

config AUDIO_CODEC_WM8994
	bool "Wolfson WM8994 codec support"
	default y
	select I2C
	depends on DT_HAS_WOLFSON_WM8994_ENABLED
	help
	  Enable support for the Wolfson/Cirrus Logic WM8994 audio codec.
```

## boards/stm32f746g-discovery/zephyr/drivers/wm8994/dts/bindings/audio/wolfson,wm8994.yaml
```yaml
# Copyright (C) 2026 Kamil Lulko <kamil.lulko@gmail.com>
#
# SPDX-License-Identifier: GPL-3.0-or-later
#
# This file is part of oveRTOS.

description: Wolfson/Cirrus Logic WM8994 Audio Codec

include: [i2c-device.yaml]

compatible: "wolfson,wm8994"

properties:
  reg:
    required: true
```

## defconfigs/host/host_posix_example_rust_zeroheap_defconfig
```kconfig
CONFIG_OVE_APP_EXAMPLE_RUST=y
CONFIG_OVE_APP_LANG_RUST=y
CONFIG_OVE_RTOS_POSIX=y
CONFIG_OVE_BOARD_HOST_PC=y
CONFIG_OVE_SYNC=y
# CONFIG_OVE_AUDIO is not set
# CONFIG_OVE_FS is not set
CONFIG_OVE_CONSOLE=y
CONFIG_OVE_LOG=y
CONFIG_OVE_TIME=y
CONFIG_OVE_BSP=y
CONFIG_OVE_LVGL=y
CONFIG_OVE_QUEUE=y
CONFIG_OVE_TIMER=y
CONFIG_OVE_EVENTGROUP=y
# CONFIG_OVE_SHELL is not set
# CONFIG_OVE_NVS is not set
# CONFIG_OVE_WATCHDOG is not set
# CONFIG_OVE_WORKQUEUE is not set
# CONFIG_OVE_STREAM is not set
CONFIG_OVE_LOG_LEVEL_INF=y
CONFIG_POSIX_DISPLAY_WIDTH=480
CONFIG_POSIX_DISPLAY_HEIGHT=272
CONFIG_OVE_ZERO_HEAP=y
```

## defconfigs/host/posix/host_posix_benchmark_zig_defconfig
```kconfig
CONFIG_OVE_APP_BENCHMARK_ZIG=y
CONFIG_OVE_APP_LANG_ZIG=y
CONFIG_OVE_RTOS_POSIX=y
CONFIG_OVE_BOARD_HOST_PC=y
CONFIG_OVE_SYNC=y
CONFIG_OVE_CONSOLE=y
CONFIG_OVE_LOG=y
CONFIG_OVE_TIME=y
CONFIG_OVE_QUEUE=y
CONFIG_OVE_TIMER=y
CONFIG_OVE_EVENTGROUP=y
CONFIG_OVE_WORKQUEUE=y
CONFIG_OVE_STREAM=y
CONFIG_OVE_LOG_LEVEL_INF=y
```

## defconfigs/host/posix/host_posix_example_net_rust_defconfig
```kconfig
CONFIG_OVE_APP_EXAMPLE_NET_RUST=y
CONFIG_OVE_APP_LANG_RUST=y
CONFIG_OVE_RTOS_POSIX=y
CONFIG_OVE_BOARD_HOST_PC=y
CONFIG_OVE_SYNC=y
# CONFIG_OVE_AUDIO is not set
# CONFIG_OVE_FS is not set
CONFIG_OVE_CONSOLE=y
CONFIG_OVE_LOG=y
CONFIG_OVE_TIME=y
CONFIG_OVE_BSP=y
# CONFIG_OVE_LVGL is not set
CONFIG_OVE_QUEUE=y
CONFIG_OVE_TIMER=y
CONFIG_OVE_EVENTGROUP=y
# CONFIG_OVE_SHELL is not set
# CONFIG_OVE_NVS is not set
# CONFIG_OVE_WATCHDOG is not set
# CONFIG_OVE_WORKQUEUE is not set
# CONFIG_OVE_STREAM is not set
CONFIG_OVE_NET=y
CONFIG_OVE_NET_HTTP=y
CONFIG_OVE_NET_MQTT=y
CONFIG_OVE_NET_HTTPD=y
CONFIG_OVE_LOG_LEVEL_INF=y
```

## defconfigs/qemu/freertos/qemu_freertos_example_net_defconfig
```kconfig
CONFIG_OVE_APP_EXAMPLE_NET=y
CONFIG_OVE_APP_LANG_C=y
CONFIG_OVE_RTOS_FREERTOS=y
CONFIG_OVE_BOARD_QEMU_MPS2_AN500=y
CONFIG_OVE_SYNC=y
CONFIG_OVE_CONSOLE=y
CONFIG_OVE_LOG=y
CONFIG_OVE_TIME=y
CONFIG_OVE_BSP=y
CONFIG_OVE_NET=y
CONFIG_OVE_NET_HTTP=y
CONFIG_OVE_NET_MQTT=y
CONFIG_OVE_NET_HTTPD=y
CONFIG_OVE_LOG_LEVEL_INF=y
CONFIG_FREERTOS_TIMER_TASK_STACK_DEPTH=512
CONFIG_FREERTOS_SOURCE_GIT=y
CONFIG_OVE_TOOLCHAIN_DOWNLOAD=y
```

## defconfigs/qemu/nuttx/qemu_nuttx_example_c_zeroheap_defconfig
```kconfig
CONFIG_OVE_APP_EXAMPLE_C=y
CONFIG_OVE_APP_LANG_C=y
CONFIG_OVE_RTOS_NUTTX=y
CONFIG_OVE_BOARD_QEMU_MPS2_AN500=y
CONFIG_OVE_SYNC=y
# CONFIG_OVE_AUDIO is not set
# CONFIG_OVE_FS is not set
CONFIG_OVE_CONSOLE=y
CONFIG_OVE_LOG=y
CONFIG_OVE_TIME=y
CONFIG_OVE_BSP=y
CONFIG_OVE_LVGL=y
CONFIG_OVE_QUEUE=y
CONFIG_OVE_TIMER=y
CONFIG_OVE_EVENTGROUP=y
# CONFIG_OVE_SHELL is not set
# CONFIG_OVE_NVS is not set
# CONFIG_OVE_WATCHDOG is not set
# CONFIG_OVE_WORKQUEUE is not set
# CONFIG_OVE_STREAM is not set
CONFIG_OVE_LOG_LEVEL_INF=y
CONFIG_NUTTX_SOURCE_GIT=y
CONFIG_OVE_TOOLCHAIN_DOWNLOAD=y
CONFIG_OVE_ZERO_HEAP=y
```

## defconfigs/qemu/qemu_zephyr_example_c_defconfig
```kconfig
CONFIG_OVE_APP_EXAMPLE_C=y
CONFIG_OVE_APP_LANG_C=y
CONFIG_OVE_RTOS_ZEPHYR=y
CONFIG_OVE_BOARD_QEMU_MPS2_AN500=y
CONFIG_OVE_SYNC=y
# CONFIG_OVE_AUDIO is not set
# CONFIG_OVE_FS is not set
CONFIG_OVE_CONSOLE=y
CONFIG_OVE_LOG=y
CONFIG_OVE_TIME=y
CONFIG_OVE_BSP=y
CONFIG_OVE_LVGL=y
CONFIG_OVE_QUEUE=y
CONFIG_OVE_TIMER=y
CONFIG_OVE_EVENTGROUP=y
# CONFIG_OVE_SHELL is not set
# CONFIG_OVE_NVS is not set
# CONFIG_OVE_WATCHDOG is not set
# CONFIG_OVE_WORKQUEUE is not set
# CONFIG_OVE_STREAM is not set
CONFIG_OVE_LOG_LEVEL_INF=y
# QEMU has no I2S, SD card, or CMSIS-DSP hardware
# CONFIG_ZEPHYR_I2S is not set
# CONFIG_ZEPHYR_CMSIS_DSP is not set
# CONFIG_ZEPHYR_SD_FILESYSTEM is not set
CONFIG_ZEPHYR_SOURCE_WEST=y
```

## defconfigs/qemu/zephyr/qemu_zephyr_example_rust_defconfig
```kconfig
CONFIG_OVE_APP_EXAMPLE_RUST=y
CONFIG_OVE_APP_LANG_RUST=y
CONFIG_OVE_RTOS_ZEPHYR=y
CONFIG_OVE_BOARD_QEMU_MPS2_AN500=y
CONFIG_OVE_RUST_TOOLCHAIN_SYSTEM=y
CONFIG_OVE_RUST_TARGET="thumbv7em-none-eabi"
CONFIG_OVE_SYNC=y
CONFIG_OVE_CONSOLE=y
CONFIG_OVE_LOG=y
CONFIG_OVE_TIME=y
CONFIG_OVE_BSP=y
CONFIG_OVE_LVGL=y
CONFIG_OVE_QUEUE=y
CONFIG_OVE_TIMER=y
CONFIG_OVE_LOG_LEVEL_INF=y
# QEMU has no I2S, SD card, or CMSIS-DSP hardware
# CONFIG_ZEPHYR_I2S is not set
# CONFIG_ZEPHYR_CMSIS_DSP is not set
# CONFIG_ZEPHYR_SD_FILESYSTEM is not set
CONFIG_ZEPHYR_SOURCE_WEST=y
```

## defconfigs/stm32f746/freertos/stm32f746_freertos_example_cpp_defconfig
```kconfig
CONFIG_OVE_APP_EXAMPLE_CPP=y
CONFIG_OVE_APP_LANG_CXX=y
CONFIG_OVE_RTOS_FREERTOS=y
CONFIG_OVE_BOARD_STM32F746G_DISCO=y
CONFIG_OVE_SYNC=y
CONFIG_OVE_CONSOLE=y
CONFIG_OVE_LOG=y
CONFIG_OVE_TIME=y
CONFIG_OVE_BSP=y
CONFIG_OVE_LVGL=y
CONFIG_OVE_QUEUE=y
CONFIG_OVE_TIMER=y
CONFIG_OVE_LOG_LEVEL_INF=y
CONFIG_FREERTOS_TIMER_TASK_STACK_DEPTH=512
CONFIG_FREERTOS_SOURCE_GIT=y
CONFIG_OVE_TOOLCHAIN_DOWNLOAD=y
```

## defconfigs/stm32f746/freertos/stm32f746_freertos_example_keyword_live_defconfig
```kconfig
CONFIG_OVE_APP_EXAMPLE_KEYWORD_LIVE=y
CONFIG_OVE_APP_LANG_C=y
CONFIG_OVE_RTOS_FREERTOS=y
CONFIG_OVE_BOARD_STM32F746G_DISCO=y
CONFIG_OVE_SYNC=y
CONFIG_OVE_AUDIO=y
# CONFIG_OVE_FS is not set
CONFIG_OVE_CONSOLE=y
CONFIG_OVE_LOG=y
CONFIG_OVE_TIME=y
# CONFIG_OVE_BSP is not set
# CONFIG_OVE_LVGL is not set
# CONFIG_OVE_QUEUE is not set
# CONFIG_OVE_TIMER is not set
# CONFIG_OVE_EVENTGROUP is not set
# CONFIG_OVE_SHELL is not set
# CONFIG_OVE_NVS is not set
# CONFIG_OVE_WATCHDOG is not set
# CONFIG_OVE_WORKQUEUE is not set
# CONFIG_OVE_STREAM is not set
CONFIG_OVE_INFER=y
# CONFIG_OVE_INFER_CMSIS_NN is not set
CONFIG_OVE_LOG_LEVEL_INF=y
CONFIG_FREERTOS_TIMER_TASK_STACK_DEPTH=512
CONFIG_FREERTOS_TOTAL_HEAP_SIZE=65536
CONFIG_FREERTOS_SOURCE_GIT=y
CONFIG_OVE_TOOLCHAIN_DOWNLOAD=y
```
