## CMakeLists.txt
```
# Copyright (C) 2026 Kamil Lulko <kamil.lulko@gmail.com>
#
# SPDX-License-Identifier: GPL-3.0-or-later
#
# This file is part of oveRTOS.

cmake_minimum_required(VERSION 3.20.0)
option(OVE_ZERO_HEAP "Build the zero-heap test variant" OFF)
if(OVE_ZERO_HEAP)
    list(APPEND EXTRA_CONF_FILE zeroheap.conf)
else()
    list(APPEND EXTRA_CONF_FILE heap.conf)
endif()

get_filename_component(OVE_SYSCALL_ROOT "${CMAKE_CURRENT_SOURCE_DIR}/../../.." ABSOLUTE)
include(${OVE_SYSCALL_ROOT}/cmake/OveZephyrSyscalls.cmake)
ove_zephyr_register_eventgroup_syscalls()
find_package(Zephyr REQUIRED HINTS $ENV{ZEPHYR_BASE})
project(ove_test_zephyr_qemu)

# Fetch CMocka (source only — Zephyr ARM libc lacks sigjmp_buf for standard build)
include(FetchContent)
FetchContent_Declare(
    cmocka
    GIT_REPOSITORY https://gitlab.com/cmocka/cmocka.git
    GIT_TAG        cmocka-1.1.7
    GIT_SHALLOW    TRUE
)
FetchContent_GetProperties(cmocka)
if(NOT cmocka_POPULATED)
    FetchContent_Populate(cmocka)
endif()
zephyr_library_named(cmocka_lib)
zephyr_library_sources(${cmocka_SOURCE_DIR}/src/cmocka.c)
zephyr_library_include_directories(${cmocka_SOURCE_DIR}/include ${cmocka_SOURCE_DIR}/src)
zephyr_library_compile_definitions(
    HAVE_STRINGS_H HAVE_INTTYPES_H HAVE_MALLOC_H
    HAVE_SIGNAL_H
    HAVE_SETJMP_H HAVE_STDARG_H HAVE_STDDEF_H HAVE_STDINT_H
    HAVE_STDIO_H HAVE_STDLIB_H HAVE_STRING_H
    HAVE_CALLOC HAVE_EXIT HAVE_FREE HAVE_LONGJMP HAVE_MALLOC
    HAVE_MEMCPY HAVE_MEMSET HAVE_SETJMP HAVE_STRCMP HAVE_SPRINTF
    HAVE_VSNPRINTF HAVE_FPRINTF HAVE_PRINTF
    HAVE_UINTPTR_T
)
zephyr_library_compile_options(-Wno-unused-parameter -Wno-implicit-function-declaration -Wno-int-conversion)

# --- Paths ---
set(OVE_ROOT ${CMAKE_CURRENT_SOURCE_DIR}/../../..)
set(OVE_INCLUDE ${OVE_ROOT}/include)
set(ZEPHYR_BACKEND ${OVE_ROOT}/backends/zephyr)
set(TESTS_ROOT ${CMAKE_CURRENT_SOURCE_DIR}/../..)
set(STUB_DIR ${TESTS_ROOT}/backends/stub)
set(SUITE_DIR ${TESTS_ROOT}/suites)
include(${TESTS_ROOT}/cmake/OveTest.cmake)

# --- Pure Zephyr backend modules (10, direct-linked) ---
set(ZEPHYR_BACKEND_SOURCES
    ${ZEPHYR_BACKEND}/zephyr_thread.c
    ${ZEPHYR_BACKEND}/zephyr_sync.c
    ${OVE_ROOT}/src/ove_sync.c
    ${ZEPHYR_BACKEND}/zephyr_queue.c
    ${OVE_ROOT}/src/ove_queue.c
    ${ZEPHYR_BACKEND}/zephyr_timer.c
    ${OVE_ROOT}/src/ove_timer.c
    ${ZEPHYR_BACKEND}/zephyr_time.c
    ${ZEPHYR_BACKEND}/zephyr_eventgroup.c
    ${OVE_ROOT}/src/ove_eventgroup.c
    ${ZEPHYR_BACKEND}/zephyr_workqueue.c
    ${OVE_ROOT}/src/ove_workqueue.c
    ${ZEPHYR_BACKEND}/zephyr_stream.c
    ${OVE_ROOT}/src/ove_stream.c
    ${OVE_ROOT}/backends/common/ove_shell.c
    # Async runtime substrate (CONFIG_OVE_ASYNC).
    ${ZEPHYR_BACKEND}/zephyr_irq.c
)

# --- Core modules (board/GPIO/LED dispatcher) ---
set(OVE_SRC ${OVE_ROOT}/src)
set(CORE_SOURCES
    ${OVE_SRC}/ove_board.c
    ${OVE_SRC}/ove_gpio.c
    ${OVE_SRC}/ove_led.c
    ${OVE_SRC}/ove_app.c
    ${OVE_SRC}/ove_media.c
)

# --- Stub backend for hardware-dependent modules (7) ---
set(STUB_SOURCES
    ${STUB_DIR}/stub_console.c
    ${STUB_DIR}/stub_watchdog.c
    ${OVE_ROOT}/backends/common/ove_nvs_ram.c
    ${STUB_DIR}/stub_fs.c
    ${OVE_ROOT}/backends/common/ove_audio_graph.c
    ${OVE_ROOT}/backends/common/ove_audio_nodes.c
    ${STUB_DIR}/stub_bsp.c
    ${STUB_DIR}/stub_board.c
    ${STUB_DIR}/stub_gpio.c
)

# --- Test suites (list sourced from cmake/OveTest.cmake) ---
ove_test_common_suite_sources(SUITE_SOURCES ${SUITE_DIR})

target_sources(app PRIVATE
    src/main.c
    ${ZEPHYR_BACKEND_SOURCES}
    ${CORE_SOURCES}
    ${STUB_SOURCES}
    ${SUITE_SOURCES}
)

target_include_directories(app PRIVATE
    # ove_config.h lives here (must be before TESTS_ROOT)
    ${CMAKE_CURRENT_SOURCE_DIR}
    ${OVE_INCLUDE}
    ${ZEPHYR_BACKEND}/include
    ${OVE_ROOT}/backends/common
    ${TESTS_ROOT}
    ${cmocka_SOURCE_DIR}/include
)

target_compile_definitions(app PRIVATE OVE_QEMU_ARM HAVE_UINTPTR_T)
zephyr_link_libraries(cmocka_lib m)

# Dispatch-overhead symbol audit (Phase 3 of moat-hardening). Zephyr
# subscope link → ELF_PATH. Symbol audit only on test scaffolding;
# hotpath disasm reserved for bench targets.
include(${OVE_ROOT}/cmake/OveZeroOverheadAudit.cmake)
if(OVE_ZERO_HEAP)
    zephyr_compile_definitions(CONFIG_OVE_ZERO_HEAP=1)
    target_sources(app PRIVATE
        ${OVE_ROOT}/backends/common/ove_heap_lock.c
        ${ZEPHYR_BACKEND}/zephyr_heap_lock.c
    )
    # Wrapping memalign also pulls in picolibc's conflicting aligned_alloc.
    zephyr_ld_options(-Wl,--wrap=malloc -Wl,--wrap=calloc -Wl,--wrap=realloc
                      -Wl,--wrap=free -Wl,--wrap=zalloc)
    include(${OVE_ROOT}/cmake/OveZeroHeapAudit.cmake)
    ove_zero_heap_assert_no_kernel_alloc(zephyr_final
        ELF_PATH ${PROJECT_BINARY_DIR}/zephyr/zephyr.elf)
    set(OVE_PANIC_AUDIT NO_PANIC_SYMBOLS)
endif()
ove_assert_no_dispatch_overhead(app
    BINDING c ${OVE_PANIC_AUDIT}
    ELF_PATH ${PROJECT_BINARY_DIR}/zephyr/zephyr.elf)
```

## prj.conf
```kconfig
CONFIG_MAIN_STACK_SIZE=16384
CONFIG_THREAD_STACK_INFO=y
CONFIG_THREAD_NAME=y
CONFIG_EVENTS=y
CONFIG_THREAD_CUSTOM_DATA=y
CONFIG_CONSOLE=y
# Picolibc + POSIX file syscalls.  cmocka.c:2421-2477 (cmprintf_group_finish_xml)
# syntactically references fopen/fclose for JUnit XML output; symbols are link-
# time pulled regardless of runtime path, dragging picolibc tinystdio's fopen
# which needs open/read/write/close/lseek.  Zephyr's POSIX subsystem provides
# them (open/close/read/write under POSIX_DEVICE_IO; lseek under POSIX_FD_MGMT).
# Without CMOCKA_XML_FILE set in the env, cmocka's fp==NULL guard at
# cmocka.c:2447 skips XML emission gracefully.
CONFIG_PICOLIBC=y
CONFIG_PICOLIBC_USE_MODULE=y
CONFIG_PICOLIBC_IO_LONG_LONG=y
CONFIG_POSIX_SYSTEM_INTERFACES=y
CONFIG_POSIX_DEVICE_IO=y
CONFIG_POSIX_FD_MGMT=y
# POSIX_DEVICE_IO `select`s ZVFS_DEFAULT_FILE_VMETHODS, whose default vmethods
# call into Zephyr's filesystem subsys (fs_open/fs_read/fs_write/fs_seek/etc.).
# Enable FILE_SYSTEM to provide those symbols — no FS is mounted, so runtime
# fs_* calls return -ENOENT.  Cmocka's XML path never reaches them anyway
# (CMOCKA_XML_FILE not set), so this is a pure link-time fixup.
CONFIG_FILE_SYSTEM=y
# CONFIG_QEMU_TARGET is derived from board selection — do not set directly
# One preemptible priority per ove priority (backends/zephyr/include/ove_zephyr_priority.h).
CONFIG_NUM_PREEMPT_PRIORITIES=32
```

## heap.conf
```kconfig
CONFIG_DYNAMIC_THREAD=y
CONFIG_DYNAMIC_THREAD_ALLOC=y
CONFIG_HEAP_MEM_POOL_SIZE=1048576
```

## zeroheap.conf
```kconfig
# ove_thread_list() needs the registry that dynamic threads normally select.
CONFIG_THREAD_MONITOR=y
CONFIG_HEAP_MEM_POOL_SIZE=0
```

## src/main.c
```c
#include "framework/ove_test.h"
#include "framework/semihosting_exit.h"
#include <stdio.h>
#include <stdlib.h>

#ifdef CONFIG_COVERAGE_SEMIHOST
#include <zephyr/debug/gcov.h>
#endif

/* Stub — tests exercise ove_app module without a real app entry point */
void ove_main(void)
{
}

int main(void)
{
	int failures = 0;

	/* FS tests skipped — no filesystem on bare-metal QEMU */
#define OVE_SUITE(name, label)               \
	printf("=== " label " Tests ===\n"); \
	failures += test_##name##_run();
#include "framework/suites.inc"

	printf("\n=== Summary: %d test group(s) had failures ===\n", failures);
#ifdef CONFIG_COVERAGE_SEMIHOST
	/* Zephyr normally auto-invokes this when main() returns
	 * (kernel/init.c), but we terminate via the SYS_EXIT semihosting trap
	 * to close the QEMU process, which bypasses that path — so dump
	 * explicitly here. */
	gcov_coverage_semihost();
#endif
	semihosting_exit(failures ? 1 : 0);
}
```
