## CMakeLists.txt
```
# Copyright (C) 2026 Kamil Lulko <kamil.lulko@gmail.com>
#
# SPDX-License-Identifier: GPL-3.0-or-later
#
# This file is part of oveRTOS.

cmake_minimum_required(VERSION 3.20.0)
get_filename_component(OVE_SYSCALL_ROOT "${CMAKE_CURRENT_SOURCE_DIR}/../../.." ABSOLUTE)
include(${OVE_SYSCALL_ROOT}/cmake/OveZephyrSyscalls.cmake)
ove_zephyr_register_eventgroup_syscalls()
find_package(Zephyr REQUIRED HINTS $ENV{ZEPHYR_BASE})
project(ove_test_zephyr)

# Fetch CMocka
include(FetchContent)
FetchContent_Declare(
    cmocka
    GIT_REPOSITORY https://gitlab.com/cmocka/cmocka.git
    GIT_TAG        cmocka-1.1.7
)
set(WITH_EXAMPLES OFF CACHE BOOL "" FORCE)
set(UNIT_TESTING ON CACHE BOOL "" FORCE)
FetchContent_MakeAvailable(cmocka)

# --- Paths ---
set(OVE_ROOT ${CMAKE_CURRENT_SOURCE_DIR}/../../..)
set(OVE_INCLUDE ${OVE_ROOT}/include)
set(ZEPHYR_BACKEND ${OVE_ROOT}/backends/zephyr)
set(TESTS_ROOT ${CMAKE_CURRENT_SOURCE_DIR}/../..)
set(STUB_DIR ${TESTS_ROOT}/backends/stub)
set(SUITE_DIR ${TESTS_ROOT}/suites)
include(${TESTS_ROOT}/cmake/OveTest.cmake)

# --- Pure Zephyr backend modules (10, direct-linked) ---
set(ZEPHYR_BACKEND_SOURCES
    ${ZEPHYR_BACKEND}/zephyr_thread.c
    ${ZEPHYR_BACKEND}/zephyr_sync.c
    ${OVE_ROOT}/src/ove_sync.c
    ${ZEPHYR_BACKEND}/zephyr_queue.c
    ${OVE_ROOT}/src/ove_queue.c
    ${ZEPHYR_BACKEND}/zephyr_timer.c
    ${OVE_ROOT}/src/ove_timer.c
    ${ZEPHYR_BACKEND}/zephyr_time.c
    ${ZEPHYR_BACKEND}/zephyr_eventgroup.c
    ${OVE_ROOT}/src/ove_eventgroup.c
    ${ZEPHYR_BACKEND}/zephyr_workqueue.c
    ${OVE_ROOT}/src/ove_workqueue.c
    ${ZEPHYR_BACKEND}/zephyr_stream.c
    ${OVE_ROOT}/src/ove_stream.c
    ${OVE_ROOT}/backends/common/ove_shell.c
    # Async runtime substrate (CONFIG_OVE_ASYNC).
    ${ZEPHYR_BACKEND}/zephyr_irq.c
)

# --- Core modules (board/GPIO/LED dispatcher) ---
set(OVE_SRC ${OVE_ROOT}/src)
set(CORE_SOURCES
    ${OVE_SRC}/ove_board.c
    ${OVE_SRC}/ove_gpio.c
    ${OVE_SRC}/ove_led.c
    ${OVE_SRC}/ove_app.c
    ${OVE_SRC}/ove_media.c
)

# --- Stub backend for hardware-dependent modules (7) ---
# Console uses stub because native_sim lacks UART interrupt support
# needed by Zephyr's console_getchar()/console_init().
set(STUB_SOURCES
    ${STUB_DIR}/stub_console.c
    ${STUB_DIR}/stub_watchdog.c
    ${OVE_ROOT}/backends/common/ove_nvs_ram.c
    ${STUB_DIR}/stub_fs.c
    ${OVE_ROOT}/backends/common/ove_audio_graph.c
    ${OVE_ROOT}/backends/common/ove_audio_nodes.c
    ${STUB_DIR}/stub_bsp.c
    ${STUB_DIR}/stub_board.c
    ${STUB_DIR}/stub_gpio.c
    ${STUB_DIR}/stub_lvgl.c
)

# --- Test suites (list sourced from cmake/OveTest.cmake) ---
ove_test_common_suite_sources(SUITE_SOURCES ${SUITE_DIR})

target_sources(app PRIVATE
    src/main.c
    ${ZEPHYR_BACKEND_SOURCES}
    ${CORE_SOURCES}
    ${STUB_SOURCES}
    ${SUITE_SOURCES}
)

target_include_directories(app PRIVATE
    # ove_config.h lives here (must be before TESTS_ROOT)
    ${CMAKE_CURRENT_SOURCE_DIR}
    ${OVE_INCLUDE}
    ${ZEPHYR_BACKEND}/include
    ${OVE_ROOT}/backends/common
    ${TESTS_ROOT}
    ${cmocka_SOURCE_DIR}/include
)

target_link_libraries(app PRIVATE cmocka-static m)

# Dispatch-overhead symbol audit on the test ELF (Phase 3 of
# moat-hardening). Zephyr's final ELF is built by an internal subscope
# this directory cannot attach POST_BUILD steps to — use ELF_PATH for
# the file-level dependency hook (same pattern as the bench target in
# boards/stm32f746g-discovery/zephyr/CMakeLists.txt). Symbol audit only;
# hotpath disasm runs only on bench targets (test ELFs are CMocka
# scaffolding, not the production hot path).
include(${OVE_ROOT}/cmake/OveZeroOverheadAudit.cmake)
ove_assert_no_dispatch_overhead(app
    BINDING c
    ELF_PATH ${PROJECT_BINARY_DIR}/zephyr/zephyr.elf)
```

## prj.conf
```kconfig
CONFIG_MAIN_STACK_SIZE=16384
CONFIG_DYNAMIC_THREAD=y
CONFIG_DYNAMIC_THREAD_ALLOC=y
CONFIG_THREAD_STACK_INFO=y
CONFIG_THREAD_NAME=y
CONFIG_HEAP_MEM_POOL_SIZE=1048576
CONFIG_EVENTS=y
CONFIG_THREAD_CUSTOM_DATA=y
CONFIG_CONSOLE=y
CONFIG_COMMON_LIBC_MALLOC=y
CONFIG_COMMON_LIBC_MALLOC_ARENA_SIZE=1048576
CONFIG_NATIVE_SIM_SLOWDOWN_TO_REAL_TIME=n
# One preemptible priority per ove priority (backends/zephyr/include/ove_zephyr_priority.h).
CONFIG_NUM_PREEMPT_PRIORITIES=32
```

## overlay-coverage.conf
```kconfig
# Coverage overlay for Zephyr native_sim — applied via EXTRA_CONF_FILE by
# `ove test zephyr-coverage`. Zephyr writes .gcda files into the build tree
# at native_sim exit, ready for the standard lcov capture path.
CONFIG_COVERAGE=y
CONFIG_COVERAGE_GCOV=y
```

## src/main.c
```c
#include "framework/ove_test.h"
#include <stdio.h>
#include <stdlib.h>

/* Stub — tests exercise ove_app module without a real app entry point */
void ove_main(void)
{
}

int main(void)
{
	int failures = 0;

	/*
	 * FS tests skipped — Zephyr native_sim FS stubs conflict with Zephyr
	 * kernel FS APIs. Stub-only suites (networking helpers, I2C/SPI/UART,
	 * PM, etc.) run from the stub target only.
	 */
#define OVE_SUITE(name, label)               \
	printf("=== " label " Tests ===\n"); \
	failures += test_##name##_run();
#include "framework/suites.inc"

	printf("\n=== Summary: %d test group(s) had failures ===\n", failures);
	exit(failures ? 1 : 0);
}
```
