## prj.conf
```kconfig
# oveRTOS benchmark app — Zephyr prj.conf overlay.
#
# Avoid stack overflow in Zephyr's logging subsystem when the bench
# burst-prints many large rows back-to-back.  The bench prints ~50
# table rows + JSON envelopes per binding (each up to ~250 chars),
# which fills the default 1 KiB log buffer faster than the 2 KiB
# logging-thread stack can drain it under the deferred mode.
# Observed crash: corrupted return address on `logging_stack` lands
# the CPU in random flash code (e.g. LL_DMA_Init) executing with
# garbage args — see investigation in commit history.
#
# Two-pronged fix:
#   1. Switch to immediate logging — log calls run inline on the
#      caller's stack (the bench runner has 8 KiB), no separate
#      logging thread, no deferred buffer.
#   2. Disable LOG entirely if immediate isn't enough — printk falls
#      back to direct UART, no logging machinery at all.  Setting
#      CONFIG_LOG_MODE_MINIMAL turns LOG_INF/LOG_WRN/LOG_ERR into
#      printk wrappers; oveRTOS's `OVE_LOG_*` is independent of
#      Zephyr's LOG_* and goes through `ove_console_write` →
#      `printk` directly, so MINIMAL is sufficient for the bench
#      and shrinks the binary.
# These apply where the board enables LOG.
# ove:optional
CONFIG_LOG_MODE_MINIMAL=y
# CONFIG_LOG_MODE_DEFERRED is not set
# CONFIG_LOG_MODE_IMMEDIATE is not set

# Disable Zephyr printk's rate limiting / buffering.  The bench bursts
# ~50 rows + JSON envelopes per binding back-to-back; with the default
# asynchronous printk the UART tx ring fills before the previous chunk
# drains, dropping the tail of each bench's serial transcript (observed:
# Suite SKIPPED messages, suite headers, and individual case rows
# missing in earlier captures).  Synchronous printk gives every
# `ove_console_write` enough back-pressure to flush before the next
# call starts.  Slows the bench by a few ms total at the print boundary
# only — invisible in the per-call timings since those are DWT
# cycle-counter-bracketed, not wall-clock.
CONFIG_PRINTK_SYNC=y
# ove:optional
CONFIG_LOG_BLOCK_IN_THREAD=y
# One preemptible priority per ove priority (backends/zephyr/include/ove_zephyr_priority.h).
CONFIG_NUM_PREEMPT_PRIORITIES=32
```

## include/bench_cyccnt.h
```c
/*
 * Copyright (C) 2026 Kamil Lulko <kamil.lulko@gmail.com>
 *
 * SPDX-License-Identifier: GPL-3.0-or-later
 *
 * This file is part of oveRTOS.
 */

/*
 * Bench-only DWT cycle-counter timer (ARMv7-M and ARMv7E-M).
 *
 * Reads the Data Watchpoint and Trace unit's free-running 32-bit cycle
 * counter at 0xE0001004 directly, bypassing the per-RTOS
 * ove_time_get_ns paths (DWT-direct on FreeRTOS, SysTick-stitched on
 * NuttX, k_cycle_get_32 on Zephyr).  Goal: a uniform measurement floor
 * across all three RTOSes on the same hardware.
 *
 * Resolution: 1 cycle (= 1/BENCH_CYCCNT_HZ seconds).
 * Wrap: 32-bit, ~19.86 s at 216 MHz — fine for per-bench-case windows.
 *
 * The functions are header-only inlines so each `bench_cyccnt_read()`
 * compiles to one ARM `LDR` from absolute address — same shape across
 * C / C++ / Rust / Zig once the binding-side wrappers expose the same
 * single-volatile-read primitive (see bench_cyccnt.rs / bench_cyccnt.zig).
 *
 * This timer lives entirely inside the bench tree.  It is *not* part of
 * the oveRTOS public API.
 */

#ifndef BENCH_CYCCNT_H
#define BENCH_CYCCNT_H

#include <stdint.h>

#ifdef __cplusplus
extern "C" {
#endif

#if defined(__ARM_ARCH_7M__) || defined(__ARM_ARCH_7EM__)
#define BENCH_CYCCNT_AVAILABLE 1
#else
#define BENCH_CYCCNT_AVAILABLE 0
#endif

/*
 * Override at compile time with -DBENCH_CYCCNT_HZ=<hz> when targeting
 * a board whose CPU is not 216 MHz.  216 MHz matches the
 * STM32F746G-DISCOVERY default across all three RTOS configurations.
 */
#ifndef BENCH_CYCCNT_HZ
#define BENCH_CYCCNT_HZ 216000000u
#endif

#if BENCH_CYCCNT_AVAILABLE

#define BENCH_CYCCNT_DEMCR_ADDR 0xE000EDFCu    /* TRCENA at bit 24 */
#define BENCH_CYCCNT_DWT_CTRL_ADDR 0xE0001000u /* CYCCNTENA at bit 0 */
#define BENCH_CYCCNT_DWT_CYCCNT_ADDR 0xE0001004u

static inline void bench_cyccnt_init(void)
{
	*(volatile uint32_t *)BENCH_CYCCNT_DEMCR_ADDR |= (1u << 24);
	*(volatile uint32_t *)BENCH_CYCCNT_DWT_CYCCNT_ADDR = 0u;
	*(volatile uint32_t *)BENCH_CYCCNT_DWT_CTRL_ADDR |= 1u;
}

static inline uint32_t bench_cyccnt_read(void)
{
	return *(volatile uint32_t *)BENCH_CYCCNT_DWT_CYCCNT_ADDR;
}

static inline uint64_t bench_cyccnt_diff_ns(uint32_t start, uint32_t end)
{
	uint32_t cycles = end - start; /* unsigned wrap is well-defined */
	return (uint64_t)cycles * 1000000000ull / (uint64_t)BENCH_CYCCNT_HZ;
}

#else /* !BENCH_CYCCNT_AVAILABLE — POSIX, sim, non-ARM targets */

static inline void bench_cyccnt_init(void)
{
}

#endif /* BENCH_CYCCNT_AVAILABLE */

#ifdef __cplusplus
}
#endif

#endif /* BENCH_CYCCNT_H */
```

## include/bench_kernel.h
```c
/*
 * Copyright (C) 2026 Kamil Lulko <kamil.lulko@gmail.com>
 *
 * SPDX-License-Identifier: GPL-3.0-or-later
 *
 * This file is part of oveRTOS.
 */

#ifndef BENCH_KERNEL_H
#define BENCH_KERNEL_H

#include <stdint.h>

/*
 * Shared deterministic compute kernel for the "personality tax" benchmark
 * (axis B1 — compute).  It is compiled into BOTH worlds:
 *   - the native bench (tests/benchmarks/c, this header), and
 *   - the FDPIC Linux program (buildroot board/overtos/progs/lbench.c, which
 *     carries a byte-identical copy).
 * so B1 measures the SAME work as a privileged native thread and as an
 * unprivileged userspace process — the delta is codegen (native toolchain vs
 * arm-buildroot-uclinuxfdpiceabi-gcc -mfdpic, i.e. FDPIC PIC overhead), which
 * is a real part of the userspace cost we want to see, not a measurement bug.
 *
 * Pure uint32 arithmetic with well-defined unsigned wrap => the result is
 * identical across compiler / -O level / architecture (verified -O0 == -O2).
 * The lbench copy must stay in sync; both self-check against
 * BENCH_KERNEL_CHECKSUM so drift is caught immediately.
 *
 * ~256 xorshift32 + FNV-1a rounds/call (~1 us @216 MHz) — comfortably above
 * the timer-read noise floor so a single call is measurable.
 */
#define BENCH_KERNEL_CHECKSUM 0x855ee3aau /* bench_kernel_mix(1) */

static inline uint32_t bench_kernel_mix(uint32_t seed)
{
	uint32_t x = seed ? seed : 0x2545F491u;
	uint32_t h = 2166136261u; /* FNV-1a offset basis */
	for (int i = 0; i < 256; i++) {
		x ^= x << 13; /* xorshift32 */
		x ^= x >> 17;
		x ^= x << 5;
		h = (h ^ x) * 16777619u; /* FNV-1a prime */
	}
	return h;
}

#endif /* BENCH_KERNEL_H */
```

## include/benchmark.h
```c
/*
 * Copyright (C) 2026 Kamil Lulko <kamil.lulko@gmail.com>
 *
 * SPDX-License-Identifier: GPL-3.0-or-later
 *
 * This file is part of oveRTOS.
 */

#ifndef BENCHMARK_H
#define BENCHMARK_H

#include "ove/types.h"
#include "ove_config.h"
#include <stdint.h>

#ifdef __cplusplus
extern "C" {
#endif

#ifndef CONFIG_OVE_BENCHMARK_ITERATIONS
#define CONFIG_OVE_BENCHMARK_ITERATIONS 1000
#endif

#ifndef CONFIG_OVE_BENCHMARK_WARMUP
#define CONFIG_OVE_BENCHMARK_WARMUP 100
#endif

/*
 * CONFIG_OVE_BENCHMARK_PERCENTILES enables per-iteration sample
 * collection so the harness can report p50/p95/p99 + a trimmed mean
 * (top 1% dropped — robust against scheduler jitter and the rare
 * preempted iteration that pulls min/max around).  Adds 8 KiB of RAM
 * (sample buffer at default ITERATIONS=1000) + qsort cost per case.
 * Default y where RAM is available; gate to n on the very smallest
 * targets if needed.
 */
#ifndef CONFIG_OVE_BENCHMARK_PERCENTILES
#define CONFIG_OVE_BENCHMARK_PERCENTILES 1
#endif

typedef enum {
	BENCH_TYPE_LATENCY,
	BENCH_TYPE_THROUGHPUT,
	BENCH_TYPE_MEMORY,
} bench_type_t;

typedef struct {
	const char *name;
	bench_type_t type;
	void (*setup)(void *ctx);
	void (*run)(void *ctx);
	void (*teardown)(void *ctx);
	unsigned int iterations; /* 0 = use default from Kconfig */
	/* For sub-µs ops, the timer-call overhead around bc->run dominates
	 * the per-iteration measurement.  Setting inner_iters > 1 has the
	 * harness call run() that many times between timestamp pairs and
	 * divide elapsed by inner_iters before recording, amortising the
	 * timer cost across multiple operations.  Default 0 = treat as 1. */
	unsigned int inner_iters;
} bench_case_t;

/* One snapshot of running mean / stddev at an iteration-count
 * checkpoint.  See bench_harness.c for the checkpoint list. */
typedef struct {
	uint32_t n;	      /* iteration count at this checkpoint */
	uint64_t mean_ns;     /* Welford running mean */
	uint64_t stddev_ns_q; /* Welford running stddev × 1000 */
} bench_audit_point_t;

#define BENCH_AUDIT_MAX 6

/* Audit fields are *always* present in the struct (regardless of
 * CONFIG_OVE_BENCHMARK_NOISE_AUDIT) so the layout is identical across
 * every binding, every config, and every binary in a cross-binding
 * comparison.  The Rust and Zig mirrors (bench.rs / bench.zig) carry
 * the same fields unconditionally for the same reason — any C/Rust
 * stride mismatch silently corrupts every case past index 0 of a
 * results[] array passed to bench_emit_suite_json.  Filling the
 * audit fields is gated on the Kconfig knob; their *presence* in
 * the layout is not. */
typedef struct {
	uint64_t min_ns;
	uint64_t max_ns;
	uint64_t total_ns;
	uint32_t count;
	uint32_t ops_per_sec;
	int32_t heap_delta; /* bytes, -1 if unsupported */
	/* Set when CONFIG_OVE_BENCHMARK_PERCENTILES, else 0. */
	uint64_t p50_ns;
	uint64_t p95_ns;
	uint64_t p99_ns;
	uint64_t trimmed_mean_ns; /* top 1% samples dropped */
	uint64_t stddev_ns_q;	  /* fixed-point: stddev_ns × 1000 */
	/* Filled when CONFIG_OVE_BENCHMARK_NOISE_AUDIT=y; zero otherwise. */
	bench_audit_point_t audit_points[BENCH_AUDIT_MAX];
	uint8_t audit_count;
} bench_result_t;

typedef struct {
	const char *name;
	int (*is_enabled)(void);
	const bench_case_t *cases;
	unsigned int case_count;
} bench_suite_t;

/* Harness API */
void bench_run_case(const bench_case_t *bc, bench_result_t *result);

/* A benchmark exercises a primitive for its cost, not its result, but the oveRTOS calls
 * that can fail are OVE_NODISCARD. bench_check() takes such a result: a failure is
 * counted, and the footer reports the count, instead of branching in the measured path.
 * Always inlined: at -Os the compiler would otherwise emit a call, and the hot-path audit
 * allows a measured function to call only the primitive under test. */
extern unsigned int g_bench_failures;
static inline __attribute__((always_inline)) void bench_check(int rc)
{
	if (rc != OVE_OK)
		g_bench_failures++;
}

/* Output API */
void bench_print_header(const char *suite_name);
void bench_print_result(const bench_case_t *bc, const bench_result_t *result);
void bench_print_footer(void);

/* Memory API */
int32_t bench_get_free_heap(void);

/* Suite registrations */
extern const bench_suite_t bench_suite_compute;
extern const bench_suite_t bench_suite_time;
extern const bench_suite_t bench_suite_thread;
extern const bench_suite_t bench_suite_sync;
extern const bench_suite_t bench_suite_queue;
extern const bench_suite_t bench_suite_timer;
extern const bench_suite_t bench_suite_eventgroup;
extern const bench_suite_t bench_suite_workqueue;
extern const bench_suite_t bench_suite_stream;
extern const bench_suite_t bench_suite_native_freertos;
extern const bench_suite_t bench_suite_native_nuttx;
extern const bench_suite_t bench_suite_native_zephyr;

#if CONFIG_OVE_BENCHMARK_OUTPUT_JSON
void bench_emit_suite_json(const bench_suite_t *suite, const bench_case_t *cases,
			   const bench_result_t *results, unsigned int n);
#endif

#ifdef __cplusplus
}
#endif

#endif /* BENCHMARK_H */
```

## src/app.c
```c
/*
 * Copyright (C) 2026 Kamil Lulko <kamil.lulko@gmail.com>
 *
 * SPDX-License-Identifier: GPL-3.0-or-later
 *
 * This file is part of oveRTOS.
 */

/*
 * oveRTOS Benchmark Application
 *
 * Measures latency, throughput, and memory usage of all RTOS abstractions.
 * Output is formatted ASCII tables via OVE_LOG.
 */

#include "benchmark.h"
#include "ove/ove.h"

/* --- Suite registry --- */

static const bench_suite_t *const suites[] = {
	&bench_suite_compute,	   &bench_suite_time,
	&bench_suite_thread,	   &bench_suite_sync,
	&bench_suite_queue,	   &bench_suite_timer,
	&bench_suite_eventgroup,   &bench_suite_workqueue,
	&bench_suite_stream,	   &bench_suite_native_freertos,
	&bench_suite_native_nuttx, &bench_suite_native_zephyr,
};

#define SUITE_COUNT (sizeof(suites) / sizeof(suites[0]))

/* --- Runner thread --- */

/*
 * Max cases per suite — sized to fit any current suite (sync has the
 * largest case list at ~10 cases). Determines a static result-array
 * scratch buffer used to collect per-suite results before emitting
 * machine-readable JSON.  No heap allocation.
 */
#define MAX_CASES_PER_SUITE 32

static void benchmark_runner(void *arg)
{
	(void)arg;

	OVE_LOG_INF("=== oveRTOS Benchmark Suite ===");
	OVE_LOG_INF("Iterations: %d  Warmup: %d", CONFIG_OVE_BENCHMARK_ITERATIONS,
		    CONFIG_OVE_BENCHMARK_WARMUP);

	static bench_result_t results[MAX_CASES_PER_SUITE];

	for (unsigned int s = 0; s < SUITE_COUNT; s++) {
		const bench_suite_t *suite = suites[s];

		if (!suite->is_enabled()) {
			OVE_LOG_INF("Suite '%s': SKIPPED (module disabled)", suite->name);
			continue;
		}

		bench_print_header(suite->name);

		unsigned int n = suite->case_count;
		if (n > MAX_CASES_PER_SUITE)
			n = MAX_CASES_PER_SUITE;

		for (unsigned int c = 0; c < n; c++) {
			const bench_case_t *bc = &suite->cases[c];
			bench_run_case(bc, &results[c]);
			bench_print_result(bc, &results[c]);
		}

		bench_print_footer();

#if CONFIG_OVE_BENCHMARK_OUTPUT_JSON
		bench_emit_suite_json(suite, suite->cases, results, n);
#endif
	}

	OVE_LOG_INF("=== Benchmark complete ===");
}

/* --- App entry point --- */

/* Static thread storage + stack for the bench runner.  Using
 * `ove_thread_init` (mode-agnostic) instead of `ove_thread_create`
 * (heap-only) so the bench app builds in both heap and zero-heap
 * modes from one source. */
OVE_THREAD_DEFINE(bench_runner_storage, 8192);

void ove_main(void)
{
	OVE_LOG_INF("Benchmark app: init");

	ove_thread_t handle;
	int ret = ove_thread_init(&handle, &bench_runner_storage, "bench_run", benchmark_runner,
				  NULL, OVE_PRIO_NORMAL, 8192, bench_runner_storage_stack);
	if (ret != OVE_OK) {
		OVE_LOG_ERR("Failed to init benchmark thread: %d", ret);
		return;
	}

	/*
	 * The benchmark sets up and tears down kernel resources for each
	 * case (threads, workqueues, queues, sync primitives) at runtime,
	 * well after ove_main() has returned.
	 *
	 * In zero-heap mode setup/teardown use _init() against file-scope
	 * static storage — no kernel allocation happens, so ove_run()'s
	 * auto-lock would harmlessly fire and trap nothing.  In heap mode
	 * the create/destroy throughput cases (gated under
	 * `#ifndef CONFIG_OVE_ZERO_HEAP`) inherently allocate, which would
	 * conflict with the lock.
	 *
	 * On NuttX the kernel's task_create allocates from kmm on every
	 * thread create regardless of caller-supplied storage:
	 * sched/group/group_create.c:group_allocate() kmm_zallocs
	 * struct task_group_s for each TCB_FLAG_TTYPE_TASK.  That kmm
	 * activity inherently conflicts with ove_heap_lock, so the
	 * benchmark must bypass the auto-lock to run on NuttX.
	 *
	 * For consistency across backends, bypass on every RTOS — the
	 * scheduler kickoff is what we need; the lock is a nicety the
	 * benchmark does not benefit from.
	 */
	ove_thread_start_scheduler();

	OVE_LOG_INF("Benchmark app: shutdown");
}
```

## src/bench_compute.c
```c
/*
 * Copyright (C) 2026 Kamil Lulko <kamil.lulko@gmail.com>
 *
 * SPDX-License-Identifier: GPL-3.0-or-later
 *
 * This file is part of oveRTOS.
 */

/*
 * Compute suite — the native side of the "personality tax" comparison
 * (buildroot board/overtos/progs/lbench.c is the FDPIC userspace mirror).
 *
 *  - compute_mix : runs bench_kernel_mix() (bench_kernel.h) — the SAME kernel
 *                  the FDPIC lbench runs, so B1 measures identical work as a
 *                  privileged native thread vs an unprivileged process.  The
 *                  ratio isolates codegen / FDPIC-PIC overhead (should be ≈1).
 *  - null_call   : an out-of-line call + return with no syscall boundary — the
 *                  native floor the personality's raw null_syscall (SVC trap)
 *                  is measured against.  The delta = the syscall-boundary cost.
 */

#include "benchmark.h"
#include "bench_kernel.h"
#include "ove/ove.h"

static volatile uint32_t g_sink; /* defeat dead-code elimination */

/* B1 — identical to lbench's compute_mix. */
static void compute_mix_setup(void *ctx)
{
	(void)ctx;
	uint32_t ck = bench_kernel_mix(1u);
	OVE_LOG_INF("compute kernel checksum: 0x%08x (expect 0x%08x)%s", (unsigned int)ck,
		    (unsigned int)BENCH_KERNEL_CHECKSUM,
		    ck == BENCH_KERNEL_CHECKSUM ? "" : "  <-- MISMATCH, lbench comparison invalid");
}

static void compute_mix_run(void *ctx)
{
	(void)ctx;
	g_sink ^= bench_kernel_mix(g_sink ? g_sink : 1u);
}

/* B2 floor — plain out-of-line call/return, no kernel boundary.  noinline so
 * the compiler cannot fold it into the caller and measure nothing. */
static uint32_t __attribute__((noinline)) null_call_fn(uint32_t x)
{
	return x + 1u;
}

static void null_call_run(void *ctx)
{
	(void)ctx;
	g_sink = null_call_fn(g_sink);
}

static int compute_is_enabled(void)
{
	return 1;
}

static const bench_case_t compute_cases[] = {
	{
		.name = "compute_mix",
		.type = BENCH_TYPE_LATENCY,
		.setup = compute_mix_setup,
		.run = compute_mix_run,
		.inner_iters = 8, /* ~256-round kernel; amortise the timer read pair */
	},
	{
		.name = "null_call",
		.type = BENCH_TYPE_LATENCY,
		.run = null_call_run,
		.inner_iters = 1000, /* sub-µs call — heavy amortisation */
	},
};

const bench_suite_t bench_suite_compute = {
	.name = "compute",
	.is_enabled = compute_is_enabled,
	.cases = compute_cases,
	.case_count = sizeof(compute_cases) / sizeof(compute_cases[0]),
};
```

## src/bench_eventgroup.c
```c
/*
 * Copyright (C) 2026 Kamil Lulko <kamil.lulko@gmail.com>
 *
 * SPDX-License-Identifier: GPL-3.0-or-later
 *
 * This file is part of oveRTOS.
 */

#include "benchmark.h"
#include "ove/ove.h"

static ove_eventgroup_t bench_eg;
static ove_eventgroup_storage_t bench_eg_storage;

/* --- set/get bits --- */

static void eg_set_get_setup(void *ctx)
{
	(void)ctx;
	bench_check(ove_eventgroup_init(&bench_eg, &bench_eg_storage));
}

static void eg_set_get_run(void *ctx)
{
	(void)ctx;
	ove_eventgroup_set_bits(bench_eg, 0x01);
	ove_eventgroup_get_bits(bench_eg);
	ove_eventgroup_clear_bits(bench_eg, 0x01);
}

static void eg_set_get_teardown(void *ctx)
{
	(void)ctx;
	ove_eventgroup_deinit(bench_eg);
}

/* --- create/destroy + memory (heap-mode only) --- */
#ifndef CONFIG_OVE_ZERO_HEAP
static void eg_create_destroy_run(void *ctx)
{
	(void)ctx;
	ove_eventgroup_t eg;

	bench_check(ove_eventgroup_create(&eg));
	ove_eventgroup_destroy(eg);
}

static ove_eventgroup_t mem_eg;

static void eg_memory_run(void *ctx)
{
	(void)ctx;
	bench_check(ove_eventgroup_create(&mem_eg));
}

static void eg_memory_teardown(void *ctx)
{
	(void)ctx;
	ove_eventgroup_destroy(mem_eg);
}
#endif

/* --- Suite --- */

static int eventgroup_is_enabled(void)
{
	return 1;
}

static const bench_case_t eventgroup_cases[] = {
#ifndef CONFIG_OVE_ZERO_HEAP
	{
		.name = "memory",
		.type = BENCH_TYPE_MEMORY,
		.run = eg_memory_run,
		.teardown = eg_memory_teardown,
	},
#endif
	{
		.name = "set_get_bits",
		.type = BENCH_TYPE_LATENCY,
		.setup = eg_set_get_setup,
		.run = eg_set_get_run,
		.teardown = eg_set_get_teardown,
	},
#ifndef CONFIG_OVE_ZERO_HEAP
	{
		.name = "create_destroy",
		.type = BENCH_TYPE_LATENCY,
		.run = eg_create_destroy_run,
	},
#endif
};

const bench_suite_t bench_suite_eventgroup = {
	.name = "eventgroup",
	.is_enabled = eventgroup_is_enabled,
	.cases = eventgroup_cases,
	.case_count = sizeof(eventgroup_cases) / sizeof(eventgroup_cases[0]),
};
```

## src/bench_harness.c
```c
/*
 * Copyright (C) 2026 Kamil Lulko <kamil.lulko@gmail.com>
 *
 * SPDX-License-Identifier: GPL-3.0-or-later
 *
 * This file is part of oveRTOS.
 */

#include "benchmark.h"
#include "bench_cyccnt.h"
#include "ove/ove.h"
#include <stdlib.h>
#include <string.h>

unsigned int g_bench_failures;

#if defined(CONFIG_OVE_BENCHMARK_WORST_CASE_TIMING) && defined(CONFIG_OVE_BOARD_STM32F746G_DISCO)
/* Direct register access for cache / accelerator disable so the bench
 * harness compiles identically against FreeRTOS, NuttX, and Zephyr —
 * the FreeRTOS port stages stm32f7xx.h on its include path but NuttX
 * and Zephyr resolve STM32F7 registers through different headers we
 * don't want to thread through the bench app.  The addresses and bit
 * positions below are ARMv7-M / STM32F7 spec — they don't change.
 *
 * Cortex-M7 SCB (System Control Block) at 0xE000ED00:
 *   CCR     = +0x14  (Configuration and Control Register)
 *     bit 16: DC   — Data cache enable
 *     bit 17: IC   — Instruction cache enable
 *     bit 18: BP   — Branch prediction enable
 *   CCSIDR  = +0x80  (Cache Size ID Register, read-only)
 *   CSSELR  = +0x84  (Cache Size Selection Register)
 *   ICIALLU = +0x250 (I-Cache Invalidate All to PoU)
 *   DCCISW  = +0x274 (D-Cache Clean and Invalidate by Set/Way)
 *
 * STM32F7 FLASH controller at 0x40023C00:
 *   ACR     = +0x00 (Access Control Register)
 *     bit 8: PRFTEN — flash prefetch enable
 *     bit 9: ARTEN  — ART accelerator enable */
/* clang-format off */
#define _OVE_BENCH_REG32(addr) (*(volatile uint32_t *)(addr))
#define _OVE_BENCH_SCB_BASE     0xE000ED00UL
#define _OVE_BENCH_SCB_CCR      _OVE_BENCH_REG32(_OVE_BENCH_SCB_BASE + 0x014)
#define _OVE_BENCH_SCB_CCSIDR   _OVE_BENCH_REG32(_OVE_BENCH_SCB_BASE + 0x080)
#define _OVE_BENCH_SCB_CSSELR   _OVE_BENCH_REG32(_OVE_BENCH_SCB_BASE + 0x084)
#define _OVE_BENCH_SCB_ICIALLU  _OVE_BENCH_REG32(_OVE_BENCH_SCB_BASE + 0x250)
#define _OVE_BENCH_SCB_DCCISW   _OVE_BENCH_REG32(_OVE_BENCH_SCB_BASE + 0x274)
#define _OVE_BENCH_CCR_DC_Msk  (1UL << 16)
#define _OVE_BENCH_CCR_IC_Msk  (1UL << 17)
#define _OVE_BENCH_CCR_BP_Msk  (1UL << 18)

#define _OVE_BENCH_FLASH_ACR        _OVE_BENCH_REG32(0x40023C00UL)
#define _OVE_BENCH_FLASH_PRFTEN_Msk (1UL << 8)
#define _OVE_BENCH_FLASH_ARTEN_Msk  (1UL << 9)

#define _OVE_BENCH_DSB() __asm volatile ("dsb 0xF" ::: "memory")
#define _OVE_BENCH_ISB() __asm volatile ("isb 0xF" ::: "memory")
/* clang-format on */

/* Replicates CMSIS SCB_DisableICache(): DSB/ISB, clear CCR.IC,
 * invalidate I-cache to PoU, DSB/ISB. */
static inline void _ove_bench_disable_icache(void)
{
	_OVE_BENCH_DSB();
	_OVE_BENCH_ISB();
	_OVE_BENCH_SCB_CCR &= ~_OVE_BENCH_CCR_IC_Msk;
	_OVE_BENCH_SCB_ICIALLU = 0UL;
	_OVE_BENCH_DSB();
	_OVE_BENCH_ISB();
}

/* Replicates CMSIS SCB_DisableDCache(): select L1 D-cache, clear CCR.DC,
 * walk every set/way and clean+invalidate, DSB/ISB.  CCSIDR encoding:
 *   bits  0-2  = LineSize  (log2(line bytes / 16))
 *   bits  3-12 = Associativity − 1 (ways)
 *   bits 13-27 = NumSets − 1       (sets) */
static inline void _ove_bench_disable_dcache(void)
{
	uint32_t ccsidr;
	uint32_t sets;
	uint32_t ways;

	_OVE_BENCH_SCB_CSSELR = 0U; /* select L1 D-cache */
	_OVE_BENCH_DSB();

	ccsidr = _OVE_BENCH_SCB_CCSIDR;
	_OVE_BENCH_SCB_CCR &= ~_OVE_BENCH_CCR_DC_Msk;

	sets = (ccsidr >> 13) & 0x7FFFU;
	do {
		ways = (ccsidr >> 3) & 0x3FFU;
		do {
			_OVE_BENCH_SCB_DCCISW = ((sets & 0x1FFU) << 5) | ((ways & 0x3U) << 30);
		} while (ways-- != 0U);
	} while (sets-- != 0U);

	_OVE_BENCH_DSB();
	_OVE_BENCH_ISB();
}
#endif

/*
 * Bench timer: on ARMv7-M targets read the DWT cycle counter directly
 * so the per-bench-case measurement floor is identical across FreeRTOS,
 * NuttX, and Zephyr.  On non-ARM (POSIX, sim) fall back to
 * ove_time_get_ns since DWT does not exist.  The branch is selected at
 * compile time; the hot path is one inline volatile load.
 */
#if BENCH_CYCCNT_AVAILABLE
static inline uint64_t bench_timestamp(void)
{
	return (uint64_t)bench_cyccnt_read();
}
static inline uint64_t bench_elapsed_ns(uint64_t start, uint64_t end)
{
	return bench_cyccnt_diff_ns((uint32_t)start, (uint32_t)end);
}
#else
static inline uint64_t bench_timestamp(void)
{
	uint64_t t = 0;
	ove_time_get_ns(&t);
	return t;
}
static inline uint64_t bench_elapsed_ns(uint64_t start, uint64_t end)
{
	return end - start;
}
#endif

/* Worst-case timing toggle: at the start of the first bench case,
 * disable every STM32F7 hardware feature that hides flash-fetch
 * latency or otherwise injects non-determinism into per-call timing —
 * Cortex-M7 I-cache + D-cache, branch prediction (SCB->CCR BP bit
 * enabled by stm32f7_mcu_init), and the STM32F7 ART accelerator +
 * flash prefetch buffer (FLASH->ACR).  Approximates the timing of a
 * cacheless ARM MCU (Cortex-M0+, M3, lower-end M4) so the published
 * numbers don't overstate performance for that target class.  See
 * app.yaml for the Kconfig.  Applies to all 4 bindings since this
 * file is shared C. */
static void bench_apply_diagnostics_once(void)
{
#if defined(CONFIG_OVE_BENCHMARK_WORST_CASE_TIMING) && defined(CONFIG_OVE_BOARD_STM32F746G_DISCO)
	static int worst_case_applied = 0;
	if (!worst_case_applied) {
		_ove_bench_disable_icache();
		_ove_bench_disable_dcache();
		_OVE_BENCH_SCB_CCR &= ~_OVE_BENCH_CCR_BP_Msk;
		_OVE_BENCH_DSB();
		_OVE_BENCH_ISB();
		_OVE_BENCH_FLASH_ACR &= ~(_OVE_BENCH_FLASH_ARTEN_Msk | _OVE_BENCH_FLASH_PRFTEN_Msk);
		_OVE_BENCH_DSB();
		_OVE_BENCH_ISB();
		worst_case_applied = 1;
		OVE_LOG_INF(
			"[diag] worst-case timing: I-cache, D-cache, branch predictor, ART, prefetch DISABLED");
	}
#endif
#if BENCH_CYCCNT_AVAILABLE
	static int cyccnt_inited = 0;
	if (!cyccnt_inited) {
		bench_cyccnt_init();
		cyccnt_inited = 1;
	}
#endif
}

#if CONFIG_OVE_BENCHMARK_PERCENTILES || CONFIG_OVE_BENCHMARK_NOISE_AUDIT
/*
 * Welford running variance — stable and avoids the catastrophic
 * cancellation a naive sum-of-squares would suffer at ns latencies
 * with µs-scale outliers.  Compiled whenever percentiles or the
 * iteration-count noise audit need running mean/stddev.
 */
struct welford {
	uint64_t n;
	double mean; /* ns */
	double m2;
};

static void welford_push(struct welford *w, uint64_t sample)
{
	w->n++;
	double delta = (double)sample - w->mean;
	w->mean += delta / (double)w->n;
	double delta2 = (double)sample - w->mean;
	w->m2 += delta * delta2;
}

static uint64_t welford_stddev_q1000(const struct welford *w)
{
	if (w->n < 2)
		return 0;
	double var = w->m2 / (double)(w->n - 1);
	double sd = 0.0;
	if (var > 0.0) {
		/* Newton-Raphson sqrt — picolibc/newlib's sqrt() pulls in
		 * fenv on bare-metal targets and is overkill for a stddev
		 * report. ~6 iterations converges to sub-ppm accuracy from
		 * any positive seed.
		 */
		double x = var;
		for (int i = 0; i < 8; i++)
			x = 0.5 * (x + var / x);
		sd = x;
	}
	if (sd < 0.0)
		sd = 0.0;
	return (uint64_t)(sd * 1000.0 + 0.5);
}
#endif /* PERCENTILES || NOISE_AUDIT */

#if CONFIG_OVE_BENCHMARK_PERCENTILES
/*
 * Static sample buffer (BSS) — sized at CONFIG_OVE_BENCHMARK_ITERATIONS.
 * Cases that override `iterations` with a higher value get full
 * mean/min/max coverage but their percentiles are computed on the first
 * SAMPLE_BUFFER_SIZE samples only.  Default 1000 samples = 8 KiB.
 */
#define SAMPLE_BUFFER_SIZE CONFIG_OVE_BENCHMARK_ITERATIONS
static uint64_t sample_buffer[SAMPLE_BUFFER_SIZE];

static int u64_cmp(const void *a, const void *b)
{
	uint64_t va = *(const uint64_t *)a;
	uint64_t vb = *(const uint64_t *)b;
	return (va > vb) - (va < vb);
}

static void compute_percentiles(uint64_t *samples, unsigned int n, bench_result_t *r)
{
	qsort(samples, n, sizeof(uint64_t), u64_cmp);

	r->p50_ns = samples[(n * 50) / 100];
	r->p95_ns = samples[(n * 95) / 100];
	if (n > 1)
		r->p99_ns = samples[((uint64_t)(n - 1) * 99) / 100];
	else
		r->p99_ns = samples[0];

	/* Trimmed mean: drop top 1% (rounded up to ≥1 sample on small
	 * counts) — robust against the occasional preempted iteration
	 * that would otherwise drag the arithmetic mean upward. */
	unsigned int trim = n / 100;
	if (trim == 0 && n > 10)
		trim = 1;
	unsigned int kept = n - trim;
	if (kept == 0)
		kept = n;
	uint64_t sum = 0;
	for (unsigned int i = 0; i < kept; i++)
		sum += samples[i];
	r->trimmed_mean_ns = sum / kept;
}
#endif /* CONFIG_OVE_BENCHMARK_PERCENTILES */

#if CONFIG_OVE_BENCHMARK_NOISE_AUDIT
/* Iteration-count checkpoints at which to snapshot running mean and
 * stddev for the calibrate-then-lock methodology.  Reader script
 * (scripts/bench_audit.py) plots CV = stddev/mean against N and picks
 * the elbow as the production iteration count. */
static const uint32_t AUDIT_CHECKPOINTS[] = {100, 500, 1000, 2500, 5000, 10000};
#define AUDIT_CHECKPOINT_COUNT (sizeof(AUDIT_CHECKPOINTS) / sizeof(AUDIT_CHECKPOINTS[0]))
#endif

void bench_run_case(const bench_case_t *bc, bench_result_t *result)
{
	bench_apply_diagnostics_once();

	unsigned int iters = bc->iterations;
	unsigned int warmup = CONFIG_OVE_BENCHMARK_WARMUP;

	if (iters == 0)
		iters = CONFIG_OVE_BENCHMARK_ITERATIONS;

#if CONFIG_OVE_BENCHMARK_NOISE_AUDIT
	/* Audit mode: bump default-case iteration count to the highest
	 * checkpoint (10 000) so we get convergence data per case.  Cases
	 * with explicit overrides (delay_1ms, ctx_switch, …) keep their
	 * override so a 10 000-iter run of a 1 ms case doesn't blow past
	 * 10 s — checkpoints higher than `iters` simply don't fire. */
	if (bc->iterations == 0 && iters < 10000)
		iters = 10000;
#endif

	memset(result, 0, sizeof(*result));
	result->min_ns = UINT64_MAX;
	result->heap_delta = -1;

	if (bc->type == BENCH_TYPE_MEMORY) {
		int32_t best = -1;
		int attempts = 3;

		if (bc->setup)
			bc->setup(NULL);

		for (int i = 0; i < attempts; i++) {
			int32_t before = bench_get_free_heap();
			bc->run(NULL);
			int32_t after = bench_get_free_heap();

			if (bc->teardown)
				bc->teardown(NULL);

			if (before >= 0 && after >= 0) {
				int32_t delta = before - after;
				if (delta >= 0 && (best < 0 || delta < best))
					best = delta;
			}
		}

		result->heap_delta = best;
		result->count = 1;
		return;
	}

	if (bc->setup)
		bc->setup(NULL);

	unsigned int inner = bc->inner_iters ? bc->inner_iters : 1;

	/* Warmup */
	for (unsigned int i = 0; i < warmup; i++) {
		for (unsigned int j = 0; j < inner; j++)
			bc->run(NULL);
	}

#if CONFIG_OVE_BENCHMARK_PERCENTILES || CONFIG_OVE_BENCHMARK_NOISE_AUDIT
	struct welford w = {0};
#endif
#if CONFIG_OVE_BENCHMARK_PERCENTILES
	unsigned int sample_count = 0;
#endif

	/* Measurement.  For inner > 1, run() is called inner times per
	 * timestamp pair and elapsed is divided by inner — amortises the
	 * fixed timestamp overhead across multiple operations on sub-µs
	 * benchmarks (e.g. time_get_us_overhead).  The DWT cycle-counter
	 * read used on ARMv7-M is a single LDR (~5 ns at 216 MHz), much
	 * cheaper than the per-RTOS ove_time_get_ns paths. */
	for (unsigned int i = 0; i < iters; i++) {
		uint64_t start = bench_timestamp();
		for (unsigned int j = 0; j < inner; j++)
			bc->run(NULL);
		uint64_t end = bench_timestamp();

		uint64_t elapsed = bench_elapsed_ns(start, end) / inner;

		if (elapsed < result->min_ns)
			result->min_ns = elapsed;
		if (elapsed > result->max_ns)
			result->max_ns = elapsed;
		result->total_ns += elapsed;
		result->count++;

#if CONFIG_OVE_BENCHMARK_PERCENTILES || CONFIG_OVE_BENCHMARK_NOISE_AUDIT
		welford_push(&w, elapsed);
#endif
#if CONFIG_OVE_BENCHMARK_PERCENTILES
		if (sample_count < SAMPLE_BUFFER_SIZE)
			sample_buffer[sample_count++] = elapsed;
#endif
#if CONFIG_OVE_BENCHMARK_NOISE_AUDIT
		for (unsigned int k = 0; k < AUDIT_CHECKPOINT_COUNT; k++) {
			if ((uint32_t)w.n != AUDIT_CHECKPOINTS[k])
				continue;
			if (result->audit_count < BENCH_AUDIT_MAX) {
				bench_audit_point_t *p =
					&result->audit_points[result->audit_count++];
				p->n = (uint32_t)w.n;
				p->mean_ns = (uint64_t)(w.mean + 0.5);
				p->stddev_ns_q = welford_stddev_q1000(&w);
			}
			break;
		}
#endif
	}

	if (bc->teardown)
		bc->teardown(NULL);

	if (bc->type == BENCH_TYPE_THROUGHPUT && result->total_ns > 0) {
		result->ops_per_sec =
			(uint32_t)((uint64_t)result->count * 1000000000ULL / result->total_ns);
	} else if (bc->type == BENCH_TYPE_LATENCY && result->total_ns > 0) {
		result->ops_per_sec =
			(uint32_t)((uint64_t)result->count * 1000000000ULL / result->total_ns);
	}

#if CONFIG_OVE_BENCHMARK_PERCENTILES || CONFIG_OVE_BENCHMARK_NOISE_AUDIT
	if (w.n > 0)
		result->stddev_ns_q = welford_stddev_q1000(&w);
#endif
#if CONFIG_OVE_BENCHMARK_PERCENTILES
	if (sample_count > 0)
		compute_percentiles(sample_buffer, sample_count, result);
#endif
}
```

## src/bench_memory.c
```c
/*
 * Copyright (C) 2026 Kamil Lulko <kamil.lulko@gmail.com>
 *
 * SPDX-License-Identifier: GPL-3.0-or-later
 *
 * This file is part of oveRTOS.
 */

#include "benchmark.h"
#include "ove_config.h"

#if defined(CONFIG_OVE_RTOS_FREERTOS)
#include "FreeRTOS.h"

int32_t bench_get_free_heap(void)
{
#ifdef CONFIG_OVE_ZERO_HEAP
	return -1; /* No heap in zero-heap mode */
#else
	return (int32_t)xPortGetFreeHeapSize();
#endif
}

#elif defined(CONFIG_OVE_RTOS_NUTTX)
#include <malloc.h>

int32_t bench_get_free_heap(void)
{
	struct mallinfo mi = mallinfo();
	return (int32_t)mi.fordblks;
}

#elif defined(CONFIG_OVE_RTOS_ZEPHYR)
#include <zephyr/kernel.h>
#include <zephyr/sys/sys_heap.h>

extern struct k_heap _system_heap;

int32_t bench_get_free_heap(void)
{
#ifdef CONFIG_SYS_HEAP_RUNTIME_STATS
	struct sys_memory_stats stats;
	if (sys_heap_runtime_stats_get(&_system_heap.heap, &stats) == 0) {
		return (int32_t)stats.free_bytes;
	}
#endif
	return -1;
}

#else
/* Unsupported backends */

int32_t bench_get_free_heap(void)
{
	return -1;
}

#endif
```

## src/bench_native_freertos.c
```c
/*
 * Copyright (C) 2026 Kamil Lulko <kamil.lulko@gmail.com>
 *
 * SPDX-License-Identifier: GPL-3.0-or-later
 *
 * This file is part of oveRTOS.
 *
 * Native FreeRTOS baseline — bypasses oveRTOS entirely so the
 * comparison report can show "<binding> wrapper vs raw FreeRTOS API:
 * 0 ns delta within 95% CI".  Only meaningful on the FreeRTOS backend;
 * everywhere else the suite reports as disabled.
 *
 * Cases here MUST mirror operations measured in bench_thread.c,
 * bench_sync.c, bench_queue.c, and bench_stream.c so
 * scripts/bench_compare.py can join them by case stem.
 *
 * Storage strategy: every kernel object is allocated via the
 * `*Static` variants (xSemaphoreCreateMutexStatic, xQueueCreateStatic,
 * xTaskCreateStatic, ...) backed by file-scope `Static*_t` storage.
 * This keeps the file compatible with FreeRTOS zero-heap builds (where
 * `configSUPPORT_DYNAMIC_ALLOCATION=0` removes the dynamic variants
 * entirely) and makes setup paths heap-free in both modes.  The
 * `*_create_destroy_run` cases (heap-mode-only by definition) are
 * gated under `#ifndef CONFIG_OVE_ZERO_HEAP`.
 *
 * No `eventgroup` / `workqueue` cases here:
 *   - eventgroups: FreeRTOS DOES have xEventGroup* but oveRTOS event
 *     uses xTaskNotify (lighter) — comparing those side-by-side would
 *     be apples-to-orangutans.
 *   - workqueues: FreeRTOS has no native equivalent.
 */

#include "benchmark.h"
#include "ove/ove.h"

#if defined(CONFIG_OVE_RTOS_FREERTOS)

#include "FreeRTOS.h"
#include "task.h"
#include "queue.h"
#include "semphr.h"
#include "stream_buffer.h"
#include <string.h>

/* ─── Shared storage (Static* — works in both heap and zero-heap modes) ─ */

/* Sized for the largest stack any helper needs (contention/cv/evt/cs
 * pong-style helpers run lock+inc+unlock or notify-take loops that
 * fit comfortably in 512 bytes). */
#define NATIVE_TASK_STACK 512

/* Native helper tasks run where an OVE_PRIO_LOW thread runs. */
#define NATIVE_TASK_PRIO (tskIDLE_PRIORITY + OVE_PRIO_LOW)

static StaticSemaphore_t native_mtx_storage;
static StaticSemaphore_t native_rmtx_storage;
static StaticSemaphore_t native_sem_storage;
static StaticSemaphore_t native_cs_a_storage;
static StaticSemaphore_t native_cs_b_storage;
static StaticQueue_t native_queue_storage;
static uint8_t native_queue_buf[8 * sizeof(uint32_t)];
static StaticStreamBuffer_t native_stream_storage;
static uint8_t native_stream_buf[256];

static StaticTask_t native_contention_tcb;
static StackType_t native_contention_stack[NATIVE_TASK_STACK];
static StaticTask_t native_cv_tcb;
static StackType_t native_cv_stack[NATIVE_TASK_STACK];
static StaticTask_t native_evt_tcb;
static StackType_t native_evt_stack[NATIVE_TASK_STACK];
static StaticTask_t native_cs_tcb;
static StackType_t native_cs_stack[NATIVE_TASK_STACK];

static SemaphoreHandle_t native_mtx;
static SemaphoreHandle_t native_rmtx;
static SemaphoreHandle_t native_sem;
static SemaphoreHandle_t native_cs_a;
static SemaphoreHandle_t native_cs_b;
static QueueHandle_t native_queue;
static StreamBufferHandle_t native_stream;

/* ─── Mutex: lock/unlock ───────────────────────────────────────── */

static void native_mutex_lock_unlock_setup(void *ctx)
{
	(void)ctx;
	native_mtx = xSemaphoreCreateMutexStatic(&native_mtx_storage);
}

static void native_mutex_lock_unlock_run(void *ctx)
{
	(void)ctx;
	xSemaphoreTake(native_mtx, portMAX_DELAY);
	xSemaphoreGive(native_mtx);
}

static void native_mutex_lock_unlock_teardown(void *ctx)
{
	(void)ctx;
	/* No vSemaphoreDelete — undefined for static-allocated objects in
	 * zero-heap builds; storage is reusable for the next setup. */
}

/* ─── Mutex: create/destroy (heap-mode only) ───────────────────── */
#ifndef CONFIG_OVE_ZERO_HEAP
static void native_mutex_create_destroy_run(void *ctx)
{
	(void)ctx;
	SemaphoreHandle_t m = xSemaphoreCreateMutex();
	vSemaphoreDelete(m);
}
#endif

/* ─── Mutex: 2-thread contention ────────────────────────────────── */

static volatile int contention_done;
static volatile uint32_t contention_count;

static void native_contention_task(void *arg)
{
	(void)arg;
	while (!contention_done) {
		xSemaphoreTake(native_mtx, portMAX_DELAY);
		contention_count++;
		xSemaphoreGive(native_mtx);
	}
	vTaskDelete(NULL);
}

static void native_mutex_contention_setup(void *ctx)
{
	(void)ctx;
	contention_done = 0;
	contention_count = 0;
	native_mtx = xSemaphoreCreateMutexStatic(&native_mtx_storage);
	(void)xTaskCreateStatic(native_contention_task, "nat_cont", NATIVE_TASK_STACK, NULL,
				NATIVE_TASK_PRIO, native_contention_stack, &native_contention_tcb);
}

static void native_mutex_contention_run(void *ctx)
{
	(void)ctx;
	xSemaphoreTake(native_mtx, portMAX_DELAY);
	contention_count++;
	xSemaphoreGive(native_mtx);
}

static void native_mutex_contention_teardown(void *ctx)
{
	(void)ctx;
	contention_done = 1;
	/* Let the contention task observe the flag and self-delete. */
	vTaskDelay(pdMS_TO_TICKS(2));
}

/* ─── Recursive mutex: lock/unlock ─────────────────────────────── */

static void native_recursive_mutex_lock_unlock_setup(void *ctx)
{
	(void)ctx;
	native_rmtx = xSemaphoreCreateRecursiveMutexStatic(&native_rmtx_storage);
}

static void native_recursive_mutex_lock_unlock_run(void *ctx)
{
	(void)ctx;
	/* 1-deep take/give to match wrapper bench geometry — wrapper's
	 * `rmtx_lock_unlock_run` measures `ove_recursive_mutex_lock` +
	 * `ove_recursive_mutex_unlock`, a single full lock/unlock pair on
	 * a recursive-mutex type.  Earlier 2-deep variant pulled in two
	 * cheap counter-increment recursive ops (~+200 ns) that made the
	 * native column appear slower than the wrapper. */
	xSemaphoreTakeRecursive(native_rmtx, portMAX_DELAY);
	xSemaphoreGiveRecursive(native_rmtx);
}

static void native_recursive_mutex_lock_unlock_teardown(void *ctx)
{
	(void)ctx;
}

/* ─── Semaphore: take/give ─────────────────────────────────────── */

static void native_sem_take_give_setup(void *ctx)
{
	(void)ctx;
	/* Counting sem with initial count 1 to mirror POSIX `sem_init(...,1)`. */
	native_sem = xSemaphoreCreateCountingStatic(1, 1, &native_sem_storage);
}

static void native_sem_take_give_run(void *ctx)
{
	(void)ctx;
	xSemaphoreTake(native_sem, portMAX_DELAY);
	xSemaphoreGive(native_sem);
}

static void native_sem_take_give_teardown(void *ctx)
{
	(void)ctx;
}

/* ─── Semaphore: create/destroy (heap-mode only) ───────────────── */
#ifndef CONFIG_OVE_ZERO_HEAP
static void native_sem_create_destroy_run(void *ctx)
{
	(void)ctx;
	SemaphoreHandle_t s = xSemaphoreCreateBinary();
	vSemaphoreDelete(s);
}
#endif

/* ─── Condvar/event: signal/wait via task notification ──────────
 *
 * FreeRTOS lacks a native condvar primitive; xTaskNotify is the
 * canonical lightweight signaling mechanism and is what oveRTOS
 * condvar/event ultimately wraps on FreeRTOS.  Same machinery is
 * used for both `condvar_signal_wait` and `event_signal_wait`
 * baselines so the report can compare oveRTOS condvar vs oveRTOS
 * event against the same underlying FreeRTOS primitive.
 */

static TaskHandle_t native_cv_waiter;
static TaskHandle_t native_cv_signaller;
static volatile int native_cv_done;

static void native_cv_signal_task(void *arg)
{
	(void)arg;
	while (!native_cv_done) {
		xTaskNotifyGive(native_cv_waiter);
		ulTaskNotifyTake(pdTRUE, portMAX_DELAY);
	}
	vTaskDelete(NULL);
}

static void native_condvar_signal_wait_setup(void *ctx)
{
	(void)ctx;
	native_cv_done = 0;
	native_cv_waiter = xTaskGetCurrentTaskHandle();
	native_cv_signaller = xTaskCreateStatic(native_cv_signal_task, "nat_cv", NATIVE_TASK_STACK,
						NULL, NATIVE_TASK_PRIO, native_cv_stack,
						&native_cv_tcb);
}

static void native_condvar_signal_wait_run(void *ctx)
{
	(void)ctx;
	ulTaskNotifyTake(pdTRUE, portMAX_DELAY);
	xTaskNotifyGive(native_cv_signaller);
}

static void native_condvar_signal_wait_teardown(void *ctx)
{
	(void)ctx;
	native_cv_done = 1;
	xTaskNotifyGive(native_cv_signaller);
	vTaskDelay(pdMS_TO_TICKS(2));
}

/* ─── Event: signal/wait — second copy of the cv pattern ───────── */

static TaskHandle_t native_evt_waiter;
static TaskHandle_t native_evt_signaller;
static volatile int native_evt_done;

static void native_evt_signal_task(void *arg)
{
	(void)arg;
	while (!native_evt_done) {
		xTaskNotifyGive(native_evt_waiter);
		ulTaskNotifyTake(pdTRUE, portMAX_DELAY);
	}
	vTaskDelete(NULL);
}

static void native_event_signal_wait_setup(void *ctx)
{
	(void)ctx;
	native_evt_done = 0;
	native_evt_waiter = xTaskGetCurrentTaskHandle();
	native_evt_signaller = xTaskCreateStatic(native_evt_signal_task, "nat_evt",
						 NATIVE_TASK_STACK, NULL, NATIVE_TASK_PRIO,
						 native_evt_stack, &native_evt_tcb);
}

static void native_event_signal_wait_run(void *ctx)
{
	(void)ctx;
	ulTaskNotifyTake(pdTRUE, portMAX_DELAY);
	xTaskNotifyGive(native_evt_signaller);
}

static void native_event_signal_wait_teardown(void *ctx)
{
	(void)ctx;
	native_evt_done = 1;
	xTaskNotifyGive(native_evt_signaller);
	vTaskDelay(pdMS_TO_TICKS(2));
}

/* ─── Thread: yield ────────────────────────────────────────────── */

static void native_thread_yield_run(void *ctx)
{
	(void)ctx;
	taskYIELD();
}

/* ─── Thread: sleep_1ms ────────────────────────────────────────── */

static void native_thread_sleep_1ms_run(void *ctx)
{
	(void)ctx;
	vTaskDelay(pdMS_TO_TICKS(1));
}

/* ─── Thread: create/destroy (heap-mode only) ─────────────────── */
#ifndef CONFIG_OVE_ZERO_HEAP
static void native_dummy_task(void *arg)
{
	(void)arg;
	/* Block forever; parent will delete us externally. */
	while (1)
		vTaskDelay(portMAX_DELAY);
}

static void native_thread_create_destroy_run(void *ctx)
{
	(void)ctx;
	TaskHandle_t h;
	xTaskCreate(native_dummy_task, "nat_tmp", 256, NULL, tskIDLE_PRIORITY, &h);
	vTaskDelete(h);
}
#endif /* !CONFIG_OVE_ZERO_HEAP */

/* ─── Thread: context_switch (2-thread ping-pong via semaphores) ─ */

static volatile int native_cs_done;

static void native_cs_pong_task(void *arg)
{
	(void)arg;
	while (!native_cs_done) {
		xSemaphoreTake(native_cs_a, portMAX_DELAY);
		if (native_cs_done)
			break;
		xSemaphoreGive(native_cs_b);
	}
	vTaskDelete(NULL);
}

static void native_thread_context_switch_setup(void *ctx)
{
	(void)ctx;
	native_cs_a = xSemaphoreCreateBinaryStatic(&native_cs_a_storage);
	native_cs_b = xSemaphoreCreateBinaryStatic(&native_cs_b_storage);
	native_cs_done = 0;
	(void)xTaskCreateStatic(native_cs_pong_task, "nat_cs", NATIVE_TASK_STACK, NULL,
				NATIVE_TASK_PRIO, native_cs_stack, &native_cs_tcb);
}

static void native_thread_context_switch_run(void *ctx)
{
	(void)ctx;
	xSemaphoreGive(native_cs_a);
	xSemaphoreTake(native_cs_b, portMAX_DELAY);
}

static void native_thread_context_switch_teardown(void *ctx)
{
	(void)ctx;
	native_cs_done = 1;
	xSemaphoreGive(native_cs_a);
	vTaskDelay(pdMS_TO_TICKS(2));
}

/* ─── IPC queue: send/receive (single 32-bit message) ──────────── */

static void native_queue_send_receive_setup(void *ctx)
{
	(void)ctx;
	native_queue =
		xQueueCreateStatic(8, sizeof(uint32_t), native_queue_buf, &native_queue_storage);
}

static void native_queue_send_receive_run(void *ctx)
{
	(void)ctx;
	uint32_t v = 0xCAFEBABE;
	xQueueSend(native_queue, &v, portMAX_DELAY);
	xQueueReceive(native_queue, &v, portMAX_DELAY);
}

static void native_queue_send_receive_teardown(void *ctx)
{
	(void)ctx;
}

/* ─── IPC queue: create/destroy (heap-mode only) ────────────── */
#ifndef CONFIG_OVE_ZERO_HEAP
static void native_queue_create_destroy_run(void *ctx)
{
	(void)ctx;
	QueueHandle_t q = xQueueCreate(8, sizeof(uint32_t));
	vQueueDelete(q);
}
#endif

/* ─── IPC stream: send/recv 64B via stream buffer ──────────────── */

/* Static tx/rx buffers in BSS — matches wrapper bench geometry
 * (`bench_stream.c::tx_buf` / `rx_buf`).  An on-stack `uint8_t buf[64]
 * = {0};` here would compile to a per-iteration `memclr` of the
 * 64-byte frame (~50 cycles) that the wrapper bench doesn't pay,
 * making the native column appear ~400-600 ns slower than the wrapper
 * — a bench-geometry artifact, not a real cost. */
static uint8_t native_stream_tx[64];
static uint8_t native_stream_rx[64];

static void native_stream_send_recv_64B_setup(void *ctx)
{
	(void)ctx;
	/* 256-byte buffer, trigger level 1 — same shape as oveRTOS bench. */
	native_stream = xStreamBufferCreateStatic(sizeof(native_stream_buf), 1, native_stream_buf,
						  &native_stream_storage);
	memset(native_stream_tx, 0xAA, sizeof(native_stream_tx));
}

static void native_stream_send_recv_64B_run(void *ctx)
{
	(void)ctx;
	xStreamBufferSend(native_stream, native_stream_tx, 64, portMAX_DELAY);
	xStreamBufferReceive(native_stream, native_stream_rx, 64, portMAX_DELAY);
}

static void native_stream_send_recv_64B_teardown(void *ctx)
{
	(void)ctx;
}

/* ─── Suite registration ─────────────────────────────────────── */

static int native_freertos_is_enabled(void)
{
	return 1;
}

static const bench_case_t native_freertos_cases[] = {
	/* Mutex */
	{
		.name = "native_mutex_lock_unlock",
		.type = BENCH_TYPE_LATENCY,
		.setup = native_mutex_lock_unlock_setup,
		.run = native_mutex_lock_unlock_run,
		.teardown = native_mutex_lock_unlock_teardown,
	},
#ifndef CONFIG_OVE_ZERO_HEAP
	{
		.name = "native_mutex_create_destroy",
		.type = BENCH_TYPE_LATENCY,
		.run = native_mutex_create_destroy_run,
	},
#endif
	{
		.name = "native_mutex_contention_2t",
		.type = BENCH_TYPE_THROUGHPUT,
		.setup = native_mutex_contention_setup,
		.run = native_mutex_contention_run,
		.teardown = native_mutex_contention_teardown,
	},
	{
		.name = "native_recursive_mutex_lock_unlock",
		.type = BENCH_TYPE_LATENCY,
		.setup = native_recursive_mutex_lock_unlock_setup,
		.run = native_recursive_mutex_lock_unlock_run,
		.teardown = native_recursive_mutex_lock_unlock_teardown,
	},
	/* Semaphore */
	{
		.name = "native_sem_take_give",
		.type = BENCH_TYPE_LATENCY,
		.setup = native_sem_take_give_setup,
		.run = native_sem_take_give_run,
		.teardown = native_sem_take_give_teardown,
	},
#ifndef CONFIG_OVE_ZERO_HEAP
	{
		.name = "native_sem_create_destroy",
		.type = BENCH_TYPE_LATENCY,
		.run = native_sem_create_destroy_run,
	},
#endif
	/* Condvar / event (xTaskNotify-based) */
	{
		.name = "native_condvar_signal_wait",
		.type = BENCH_TYPE_LATENCY,
		.setup = native_condvar_signal_wait_setup,
		.run = native_condvar_signal_wait_run,
		.teardown = native_condvar_signal_wait_teardown,
		.iterations = 500,
	},
	{
		.name = "native_event_signal_wait",
		.type = BENCH_TYPE_LATENCY,
		.setup = native_event_signal_wait_setup,
		.run = native_event_signal_wait_run,
		.teardown = native_event_signal_wait_teardown,
		.iterations = 500,
	},
	/* Threading */
	{
		.name = "native_thread_yield",
		.type = BENCH_TYPE_LATENCY,
		.run = native_thread_yield_run,
	},
	{
		.name = "native_thread_sleep_1ms",
		.type = BENCH_TYPE_LATENCY,
		.run = native_thread_sleep_1ms_run,
		.iterations = 100,
	},
#ifndef CONFIG_OVE_ZERO_HEAP
	{
		.name = "native_thread_create_destroy",
		.type = BENCH_TYPE_LATENCY,
		.run = native_thread_create_destroy_run,
		.iterations = 200,
	},
#endif
	{
		.name = "native_thread_context_switch",
		.type = BENCH_TYPE_LATENCY,
		.setup = native_thread_context_switch_setup,
		.run = native_thread_context_switch_run,
		.teardown = native_thread_context_switch_teardown,
		.iterations = 500,
	},
	/* IPC (queue + stream buffer) */
	{
		.name = "native_queue_send_receive",
		.type = BENCH_TYPE_LATENCY,
		.setup = native_queue_send_receive_setup,
		.run = native_queue_send_receive_run,
		.teardown = native_queue_send_receive_teardown,
	},
#ifndef CONFIG_OVE_ZERO_HEAP
	{
		.name = "native_queue_create_destroy",
		.type = BENCH_TYPE_LATENCY,
		.run = native_queue_create_destroy_run,
	},
#endif
	{
		.name = "native_stream_send_recv_64B",
		.type = BENCH_TYPE_LATENCY,
		.setup = native_stream_send_recv_64B_setup,
		.run = native_stream_send_recv_64B_run,
		.teardown = native_stream_send_recv_64B_teardown,
	},
};

const bench_suite_t bench_suite_native_freertos = {
	.name = "native_freertos",
	.is_enabled = native_freertos_is_enabled,
	.cases = native_freertos_cases,
	.case_count = sizeof(native_freertos_cases) / sizeof(native_freertos_cases[0]),
};

#else /* !CONFIG_OVE_RTOS_FREERTOS */

static int native_freertos_is_enabled(void)
{
	return 0;
}

const bench_suite_t bench_suite_native_freertos = {
	.name = "native_freertos",
	.is_enabled = native_freertos_is_enabled,
	.cases = NULL,
	.case_count = 0,
};

#endif /* CONFIG_OVE_RTOS_FREERTOS */
```
