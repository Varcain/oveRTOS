/*
 * Copyright (C) 2026 Kamil Lulko <kamil.lulko@gmail.com>
 *
 * SPDX-License-Identifier: GPL-3.0-or-later
 *
 * Linux personality WITH a display (lvbench): re-enable the LTDC panel; the board overlay sets the
 * FMC read-pipe delay it needs. The common ove-linux.overlay owns the QSPI-XIP rootfs because
 * headless profiles need it too.
 * Applied AFTER ove-linux.overlay. The framebuffer (in SDRAM1, 255 KB) coexists with the
 * personality's program pool (both NOLOAD in SDRAM1, disjoint).
 */

&ltdc {
	status = "okay";
	interrupts = <88 3>, <89 3>;
};
